## lib/posix/options/Kconfig.xsi_advanced_realtime
```kconfig
# Copyright (c) 2025 Tenstorrent AI ULC
#
# SPDX-License-Identifier: Apache-2.0

config POSIX_ADVISORY_INFO
	bool "POSIX advisory information"
	help
	  Select 'y' here and the following Options will be enabled:

	  posix_fadvise(), posix_fallocate(), posix_memalign(), and posix_madvise().

	  For more information, please see
	  https://pubs.opengroup.org/onlinepubs/9699919799/xrat/V4_port.html

config POSIX_CPUTIME
	bool "POSIX per-process CPU-time clocks"
	help
	  This enables CLOCK_PROCESS_CPUTIME_ID and the function clock_getcpuclockid().

	  For more information, please see
	  https://pubs.opengroup.org/onlinepubs/9699919799/xrat/V4_port.html
	  https://pubs.opengroup.org/onlinepubs/9699919799/basedefs/V1_chap03.html#tag_03_118
	  https://pubs.opengroup.org/onlinepubs/9699919799/functions/V2_chap02.html#tag_15_08_05_04

config POSIX_SPAWN
	bool "POSIX spawn"
	help
	  This enables the POSIX spawn option and provides the following functions.

	  posix_spawn(), posix_spawnp(), posix_spawn_file_actions_addopen(),
	  posix_spawn_file_actions_adddup2(), posix_spawn_file_actions_destroy(),
	  posix_spawn_file_actions_init(), posix_spawnattr_destroy(), posix_spawnattr_getflags(),
	  posix_spawnattr_getpgroup(), posix_spawnattr_getsigdefault(),
	  posix_spawnattr_getsigmask(), posix_spawnattr_init(), posix_spawnattr_setflags(),
	  posix_spawnattr_setpgroup(), posix_spawnattr_setsigdefault(),
	  posix_spawnattr_setsigmask().

	  If the _POSIX_PRIORITY_SCHEDULING option is also enabled, then the following functions
	  will also be provided:

	  posix_spawnattr_getschedparam(), posix_spawnattr_getschedpolicy(),
	  posix_spawnattr_setschedparam(), and posix_spawnattr_setschedpolicy().

	  For more information, please see
	  https://pubs.opengroup.org/onlinepubs/9699919799/xrat/V4_port.html

config POSIX_SPORADIC_SERVER
	bool "POSIX sporadic server"
	help
	  This enables the POSIX sporadic server scheduling option (i.e. SCHED_SPORADIC).

	  For more information, please see
	  https://pubs.opengroup.org/onlinepubs/9699919799/xrat/V4_port.html

config POSIX_TYPED_MEMORY_OBJECTS
	bool "POSIX typed memory objects"
	help
	  This enables the POSIX typed memory objects option and provides the following functions.

	  posix_mem_offset(), posix_typed_mem_get_info(), posix_typed_mem_open().

	  For more information, please see
	  https://pubs.opengroup.org/onlinepubs/9699919799/xrat/V4_port.html

config XSI_ADVANCED_REALTIME
	bool "X/Open advanced realtime"
	select POSIX_ADVISORY_INFO
	select POSIX_CPUTIME
	select POSIX_SPAWN
	select POSIX_SPORADIC_SERVER
	select POSIX_TYPED_MEMORY_OBJECTS
	# An implementation that claims conformance to this Option Group shall also support the
	# Realtime Option Group.
	select XSI_REALTIME
	help
	  Select 'y' here and the following Options will be enabled:

	  _POSIX_ADVISORY_INFO
	  _POSIX_CPUTIME
	  _POSIX_SPORADIC_SERVER
	  _POSIX_TYPED_MEMORY_OBJECTS

	  Selecting this option also selects enables _XOPEN_REALTIME.

	  For more information, please see
	  https://pubs.opengroup.org/onlinepubs/9699919799/basedefs/V1_chap02.html
```

## samples/drivers/jesd216/boards/nucleo_g071rb.conf
```kconfig
CONFIG_SPI_NOR=y

CONFIG_SHELL=y
CONFIG_REBOOT=y

# CONFIG_LOG=y
# CONFIG_SPI_LOG_LEVEL_DBG=y
# CONFIG_FLASH_LOG_LEVEL_DBG=y

# CONFIG_FLASH_SHELL=y
# CONFIG_FLASH_SHELL_TEST_COMMANDS=y
# CONFIG_GPIO_SHELL=y
# CONFIG_SPI_SHELL=y
```

## soc/xtensa/espressif_esp32/esp32_net/Kconfig.series
```kconfig
# Copyright (c) 2023 Espressif Systems (Shanghai) Co., Ltd.
# SPDX-License-Identifier: Apache-2.0

config SOC_SERIES_ESP32_NET
	bool "ESP32-NET Series"
	select XTENSA
	select SOC_FAMILY_ESP32
	select CLOCK_CONTROL
	select DYNAMIC_INTERRUPTS
	select HAS_ESPRESSIF_HAL
	select NEED_POSIX_C_SOURCE if WIFI_ESP32
	help
	  Enable support for Espressif ESP32_NET
```

## subsys/net/lib/http/Kconfig
```kconfig
# Copyright (c) 2016 Intel Corporation
# SPDX-License-Identifier: Apache-2.0

config HTTP_PARSER
	bool "HTTP Parser support"
	select HTTP_PARSER_URL
	help
	  This option enables the http_parser library from nodejs.
	  This parser requires some string-related routines commonly
	  provided by a libc implementation.

config HTTP_PARSER_URL
	bool "HTTP Parser for URL support"
	help
	  This option enables the URI parser library based on source from nodejs.
	  This parser requires some string-related routines commonly
	  provided by a libc implementation.

config HTTP_PARSER_STRICT
	bool "HTTP strict parsing"
	depends on (HTTP_PARSER || HTTP_PARSER_URL)
	help
	  This option enables the strict parsing option

config HTTP_CLIENT
	bool "HTTP client API [EXPERIMENTAL]"
	select HTTP_PARSER
	select HTTP_PARSER_URL
	select EXPERIMENTAL
	help
	  HTTP client API

module = NET_HTTP
module-dep = NET_LOG
module-str = Log level for HTTP client library
module-help = Enables HTTP client code to output debug messages.
source "subsys/net/Kconfig.template.log_config.net"

config HTTP_SERVER
	bool "HTTP Server [EXPERIMENTAL]"
	select WARN_EXPERIMENTAL
	help
	  HTTP server support.
	  Note: this is a work-in-progress

module = NET_HTTP_SERVER
module-dep = NET_LOG
module-str = Log level for HTTP server
module-help = Enables HTTP server code to output debug messages.
source "subsys/net/Kconfig.template.log_config.net"

if HTTP_SERVER

config HTTP_SERVER_INIT_PRIORITY
	int "HTTP server init priority"
	default 42

choice HTTP_SERVER_CHOICE
	prompt "Choice of HTTP server implementaton"
	default HTTP_SERVER_CHOICE_PHD

config HTTP_SERVER_CHOICE_PHD
	bool "Use the Pico HTTP Daemon"
	select PHD

endchoice

endif

source "subsys/net/lib/http/server/phd/Kconfig"
```

## subsys/net/lib/http/server/Kconfig
```kconfig
config HTTP_SERVER_INIT_PRIORITY
	int "HTTP server init priority"
	default 42

choice HTTP_SERVER_CHOICE
	prompt "Choice of HTTP server implementaton"
	default HTTP_SERVER_CHOICE_PHD

config HTTP_SERVER_CHOICE_PHD
	bool "Use the Pico HTTP Daemon"

endchoice

rsource "phd/Kconfig"
```
