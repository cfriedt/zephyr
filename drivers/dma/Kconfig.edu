## drivers/dma/Kconfig.edu
```kconfig
# Edu DMA configuration options

# Copyright 2022, Meta
# SPDX-License-Identifier: Apache-2.0

config DMA_EDU
	bool "Edu DMA driver"
	depends on PCIE
	depends on PCIE_CONTROLLER
	depends on PCIE_ECAM
	depends on PCIE_MSI
	help
	  Enable this option to support Jiri Slaby's Educational CI Device.
```

## drivers/firmware/Kconfig
```kconfig
# Copyright 2024 NXP
# SPDX-License-Identifier: Apache-2.0

menu "Firmware drivers"

source "drivers/firmware/scmi/Kconfig"

endmenu
```

## drivers/firmware/rpmi/Kconfig
```kconfig
config RISCV_RPMI
	bool "Support for ARM's SCMI"
	depends on RISCV
	help
	  Enable support for RISC-V Platform Management Interface (RPMI).
```

## dts/bindings/dma/zephyr,dma-edu.yaml
```yaml
# Copyright 2022 Meta
# SPDX-License-Identifier: Apache-2.0

description: Jira Slaby's Educational PCI Device

include: dma-controller.yaml

compatible: zephyr,dma_edu

properties:
  edu-magic:
    type: int
    default: 0x00edu
    description: |
      Value of the ID register without major and minor versions
```

## dts/bindings/firmware/riscv,rpmi.yaml
```yaml
# Copyright 2024 Tenstorrent AI ULC
# SPDX-License-Identifier: Apache-2.0

description: |
        RISC-V Platform Management Interface transport description.

compatible: "riscv,rpmi"

include: [base.yaml]

properties:
  # doorbell: optional, and implemented via base.yaml properties
  # applicable to "fast-channel", "shmem", and possibly other transports.
  #
  # interrupts = <1 2 3 4>;
  # interrupt-names = "a2p-doorbell", "p2a-doorbell";

  rpmi-transport-type:
    type: string
    required: true
    enum: ["fast-channel", "shmem"]
    description: |
      TODO: Add description

  # shmem queues: optional, and implemented via base.yaml properties
  # reg-names = "a2p-req", "a2p-ack", "p2a-req", "p2a-ack";
  # reg = <0x1000 0x1000>, <0x2000 0x1000>, <0x3000 0x1000>, <0x4000 0x1000>;

  shmem-slot-size:
    type: integer
    description: |
      Queue slot size in bytes.

      Required if rpmi-transport-type is "shmem".

  fast-channel:
    type: string
    description: |
      TODO: Add description.

      Required if rpmi-transport-type is "fast-channel".
```

## dts/bindings/fpga/lattice,ice40-fpga.yaml
```yaml
# Copyright (c) 2022 Friedt Professional Engineering Services, Inc
# SPDX-License-Identifier: Apache-2.0

description: Lattice iCE40 FPGA

compatible: "lattice,ice40-fpga"

include: spi-device.yaml

properties:
    cdone-gpios:
      type: phandle-array
      required: true
      description: |
        Configuration Done output from iCE40.
        
        Example usage: 
        cdone-gpios = <&gpio0 18 0>;

    creset-gpios:
      type: phandle-array
      required: true
      description: |
        Configuration Reset input on iCE40.
        
        Example usage: 
        creset-gpios = <&gpio0 19 GPIO_OPEN_DRAIN>;
    
    creset-delay-ns:
      type: int
      required: false
      description: |
        Delay (in nanoseconds) between asserting CRESET_B and releasing CRESET_B.

        Example usage:
        creset-delay-ns = <200>;

    config-delay-us:
      type: int
      required: false
      description: |
        Delay (in microseconds) after releasing CRESET_B to clear internal configuration memory.

        Example usage:
        config-delay-us = <300>;

    leading-clocks:
      type: int
      required: false
      description: |
        Prior to sending the bitstream, issue this number of leading clocks with SPI_CS pulled high.

        Example usage:
        leading-clocks = <8>;

    trailing-clocks:
      type: int
      required: false
      description: |
        After sending the bitstream, issue this number of trailing clocks with SPI_CS pulled high.

        Example usage:
        trailing-clocks = <149>;
```

## kernel/Kconfig.signal
```kconfig
# Copyright (c) 2024, Tenstorrent AI ULC
# SPDX-License-Identifier: Apache-2.0

menu "Signal support"

config SIGNAL
	bool "Signal support"
	depends on POLL
	depends on RING_BUFFER
	help
	  Select 'y' here to support signals.

if SIGNAL

config SIGNAL_QUEUE_SIZE
	int "Signal queue size"
	range 1 256
	default 32 if SIGNAL_SUPPORT_POSIX || SIGNAL_SUPPORT_POSIX_RT
	default 1
	help
	  Size of kernel signal queue.

module := SIGNAL
module-str = k_sig
source "subsys/logging/Kconfig.template.log_config"

endif # SIGNAL

config SIGNAL_SET_SIZE
	int "Maximum number of signals"
	default 40 if SIGNAL && SIGNAL_SUPPORT_POSIX_RT
	default 31 if SIGNAL && SIGNAL_SUPPORT_POSIX && !SIGNAL_SUPPORT_POSIX_RT
	default 6 if SIGNAL && SIGNAL_SUPPORT_ISO_C && !SIGNAL_SUPPORT_POSIX && !SIGNAL_SUPPORT_POSIX_RT
	default 1 if SIGNAL
    default 0 if !SIGNAL
	help
	  Maximum number of signals that can be represented in a struct k_sigset.

endmenu

if SIGNAL

config SIGNAL_SUPPORT_ISO_C
	bool
	help
	  Support for ISO C signals.

config SIGNAL_SUPPORT_POSIX
	bool
	help
	  Support for POSIX signals (25 on top of ISO C).

config SIGNAL_SUPPORT_POSIX_RT
	bool
	help
	  Support for POSIX Realtime signals (8 on top of POSIX).

endif
```

## lib/libc/common/Kconfig.mallinfo
```kconfig
# Copyright (c) 2024 Tenstorrent AI ULC
# SPDX-License-Identifier: Apache-2.0

menuconfig COMMON_LIBC_MALLINFO2
	bool "Common C library mallinfo2()"
	depends on COMMON_LIBC_MALLOC
	help
	  Enable the common C library implementation of mallinfo2() to support
	  simplified application-level queries of memory usage and statistics.

	  Note: mallinfo2() is a non-standard GNU extension present in some C libraries.

if COMMON_LIBC_MALLINFO2

config COMMON_LIBC_MALLINFO2_HIGH_WATERMARK
	bool "Maintain a high-watermark of memory usage"
	help
	  This option enables the 'usmblks' field in the mallinfo2 structure in order to track the
	  high-watermark of heap memory usage.

config COMMON_LIBC_MALLINFO2_KEEPCOST
	bool "Maintain a metric of block statistics in mallinfo2()"
	help
	   Track small block ('fastbin') allocations.

	   Note: Zephyr's heap allocator does not perform fastbin allocations. This option exists
	   mainly for compatibility purposes.

config COMMON_LIBC_MALLINFO2_MMAP
	bool "Track allocations made via anonymous, mapped pages"
	help
	  This option enables the 'hblks' and 'hblkhd' fields in the mallinfo2 structure in order
	  to track the allocations made via anonymous, mapped pages.

	  Note: this option is not yet implemented and exists mainly for compatibility purposes.

config COMMON_LIBC_MALLINFO2_ORDBLKS
	bool "Maintain a counter for ordinary free blocks"
	help
	  This option enables the 'ordblks' field in the mallinfo2 structure in order
	  to approximate the number of ordinary, non-fastbin free blocks. This option may be useful
	  for some users who

config COMMON_LIBC_MALLINFO2_SMBLKS
	bool "Track small block allocations"
	help
	   Track small block ('fastbin') allocations.

	   Note: Zephyr's heap allocator does not perform fastbin allocations. This option exists
	   mainly for compatibility purposes.

config COMMON_LIBC_MALLINFO2_UORDBLKS
	bool ""

endif
```

## lib/posix/Kconfig.fnmatch
```kconfig
# Copyright (c) 2018 Nordic Semiconductor ASA
#
# SPDX-License-Identifier: Apache-2.0

config FNMATCH
	bool "Support for fnmatch"
	default y if POSIX_API
	select NEED_POSIX_C_SOURCE
	help
	  Match filenames using the the fnmatch function. For example, the pattern
	  "*.c" matches the filename "hello.c".
```

## lib/posix/conformance/Kconfig
```kconfig
# Copyright (c) 2024, Friedt Professional Engineering Services, Inc
#
# SPDX-License-Identifier: Apache-2.0

rsource "application/Kconfig"
```

## lib/posix/conformance/application/Kconfig
```kconfig
# Copyright (c) 2024, Friedt Professional Engineering Services, Inc
#
# SPDX-License-Identifier: Apache-2.0

menu "Application Conformance"

choice XOPEN_SOURCE_CHOICE
	prompt "Selection for _XOPEN_SOURCE"
	default XOPEN_SOURCE_CHOICE_NONE
	help
	  X/Open application conformance level.

config XOPEN_SOURCE_CHOICE_NONE
	bool "None"
	help
	  The application does not require X/Open.

config XOPEN_SOURCE_CHOICE_700
	bool "700 (IEEE 1003.1-2017)"
	help
	  Prefer _XOPEN_SOURCE=700. This is the value specified in IEEE Std. 1003.1-2008
	  and IEEE Std. 1003.1-2017.

endchoice # XOPEN_SOURCE_CHOICE

if !XOPEN_SOURCE_CHOICE_NONE

config XOPEN_SOURCE
	int
	default 700 if XOPEN_SOURCE_CHOICE_700
	default 0

endif # !XOPEN_SOURCE_CHOICE_NONE

choice POSIX_C_SOURCE_CHOICE
	prompt "Selection for _POSIX_C_SOURCE"
	default POSIX_C_SOURCE_CHOICE_NONE
	help
	  POSIX application conformance level.

config POSIX_C_SOURCE_CHOICE_NONE
	bool "None"
	help
	  The application does not require POSIX.

config POSIX_C_SOURCE_CHOICE_200809L
	bool "200809L (IEEE 1003.1-2017)"
	help
	  Prefer _POSIX_C_SOURCE=200809L. This is the value specified in both
	  IEEE Std. 1003.1-2008 and IEEE Std. 1003.1-2017.

endchoice # POSIX_C_SOURCE_CHOICE

if !POSIX_C_SOURCE_CHOICE_NONE || !XOPEN_SOURCE_CHOICE_NONE

config POSIX_C_SOURCE
	int
	default 200809 if (POSIX_C_SOURCE_CHOICE_200809L || XOPEN_SOURCE_CHOICE_700)
	default 0

endif # !POSIX_C_SOURCE_CHOICE_NONE

endmenu # "Application Conformance"
```

## lib/posix/options/Kconfig.c_lib_ext
```kconfig
# Copyright (c) 2024 Tenstorrent AI ULC
#
# SPDX-License-Identifier: Apache-2.0

menuconfig POSIX_C_LIB_EXT
	bool "POSIX extensions to the general C library"
	default y if POSIX_API
	help
	  Select 'y' here and Zephyr will provide implementations of fnmatch(), getopt(). getsubopt(),
	  optarg, opterr, optind, stpncpy, strcasecmp, strdup, strfmon(), strncasecmp(), strndup(), strnlen().

	  For more informnation, please see
	  https://pubs.opengroup.org/onlinepubs/9699919799/xrat/V4_subprofiles.html

if POSIX_C_LIB_EXT

config GETOPT_LONG
	bool "Getopt long library support"
	help
	  This option adds support of the getopt long.
	  Different shell backends are using their own instance of getopt to
	  not interfere with each other.
	  All not shell threads share one global instance of getopt state, hence
	  apart from shell this library is not thread safe. User can add support
	  for other threads by extending function getopt_state_get in
	  getopt_common.c file.

endif # POSIX_C_LIB_EXT
```

## lib/posix/options/Kconfig.device_io
```kconfig
# Copyright (c) 2024 Tenstorrent AI ULC
#
# SPDX-License-Identifier: Apache-2.0

menuconfig POSIX_DEVICE_IO
	bool "POSIX Device IO"
	default y if POSIX_API
	help
	  Select 'y' here and Zephyr will provide an implementation of the POSIX_DEVICE_IO Option
	  Group such as FD_CLR(), FD_ISSET(), FD_SET(), FD_ZERO(), close(), fdopen(), fileno(), open(),
	  poll(), pread(), pselect(), pwrite(), read(), select(), and write().

	  For more informnation, please see
	  https://pubs.opengroup.org/onlinepubs/9699919799/xrat/V4_subprofiles.html

if POSIX_DEVICE_IO

# These might end up being non-user selectable options, since they
# are fairly closely tied to the implementation.

config POSIX_DEVICEIO_ALIAS_CLOSE
	bool "Create a _close() alias for close()"
	default y
	help
	  Select 'y' here and Zephyr will provide an alias for close() as close().

config POSIX_DEVICEIO_ALIAS_OPEN
	bool "Create a _open() alias for open()"
	default y
	help
	  Select 'y' here and Zephyr will provide an alias for open() as open().

config POSIX_DEVICEIO_ALIAS_READ
	bool "Create a _read() alias for read()"
	default y
	help
	  Select 'y' here and Zephyr will provide an alias for read() as _read().

config POSIX_DEVICEIO_ALIAS_WRITE
	bool "Create a _write() alias for write()"
	default y
	help
	  Select 'y' here and Zephyr will provide an alias for write() as _write().

endif # POSIX_DEVICE_IO
```

## lib/posix/options/Kconfig.fd_mgmt
```kconfig
# Copyright (c) 2024 Tenstorrent AI ULC
#
# SPDX-License-Identifier: Apache-2.0

menuconfig POSIX_FD_MGMT
	bool "POSIX file descriptor management"
	default y if POSIX_API
	help
	  Select 'y' here and Zephyr will provide implementations for the POSIX_FD_MGMT Option Group.
	  This includes support for dup(), dup2(), fcntl(), fseeko(), ftello(), ftruncate(),
	  and lseek().

	  For more information, please see
	  https://pubs.opengroup.org/onlinepubs/9699919799/xrat/V4_subprofiles.html
```

## lib/posix/options/Kconfig.file_locking
```kconfig
# Copyright (c) 2024 Tenstorrent AI ULC
#
# SPDX-License-Identifier: Apache-2.0

config POSIX_FILE_LOCKING
    bool "POSIX File Locking"
    help
      Select 'y' here to enable flockfile(), ftrylockfile(), funlockfile(), getc_unlocked(),
      getchar_unlocked(), putc_unlocked(), and putchar_unlocked().

      For more information, please see
      https://pubs.opengroup.org/onlinepubs/9699919799/xrat/V4_subprofiles.html
```

## lib/posix/options/Kconfig.net
```kconfig
# Copyright (c) 2024, Friedt Professional Engineering Services, Inc
#
# SPDX-License-Identifier: Apache-2.0

config POSIX_NETWORKING
	bool "POSIX Networking API"
	default y if POSIX_API
	select NETWORKING
	select NET_SOCKETS
	select NET_SOCKETPAIR
	select NET_IP
	select DNS_RESOLVER
	help
	  Enable this option to support the POSIX networking API. This includes
	  support for BSD Sockets.

if POSIX_NETWORKING

config POSIX_IPV6
	bool "POSIX IPv6 networking support"
	default y if POSIX_API
	select NET_IPV6
	help
	  Enable this option to support IP version 6 networking in the POSIX API.

config POSIX_RAW_SOCKETS
	bool "POSIX raw socket support"
	default y if POSIX_API
	select NET_SOCKETS_PACKET
	help
	  Enable this option to support raw sockets in the POSIX API.

endif # POSIX_NETWORKING
```

## lib/posix/options/Kconfig.pipe
```kconfig
# Copyright (c) 2024 Tenstorrent AI ULC
#
# SPDX-License-Identifier: Apache-2.0

menuconfig POSIX_PIPE
	bool "POSIX pipes [EXPERIMENTAL]"
	select FDTABLE
	select EXPERIMENTAL
	select POLL
	select RING_BUFFER
	help
	  Select 'y' here for the pipe() function.

	  For more informnation, please see
	  https://pubs.opengroup.org/onlinepubs/9699919799/xrat/V4_subprofiles.html

if POSIX_PIPE

config POSIX_PIPE_MAX
	int "Maximum number of POSIX pipes"
	default 1
	help
	  This option determines the number of POSIX pipes available for use.

config POSIX_PIPE_BUF
	int "POSIX pipe buffer size"
	default 512
	help
	  This option sets the size of the buffer, in bytes used by the pipe() function.

endif
```

## lib/posix/options/Kconfig.system_database
```kconfig
# Copyright (c) 2024 Tenstorrent
#
# SPDX-License-Identifier: Apache-2.0

menu "POSIX System Database"

config POSIX_SYSTEM_DATABASE_R
	bool "POSIX Thread-safe System Database"
	help
	  Select 'y' here and Zephyr will provide an implementation of getgrgid_r(), getgrnam_r(),
	  getpwnam_r(), and getpwuid_r().

	  For more information, please see
	  https://pubs.opengroup.org/onlinepubs/9699919799/xrat/V4_subprofiles.html

config POSIX_SYSTEM_DATABASE
	bool "POSIX System Database"
	depends on POSIX_SYSTEM_DATABASE_R
	help
	  Select 'y' here and Zephyr will provide an implementation of getgrgid(), getgrnam(),
	  getpwnam(), and getpwuid().

	  For more information, please see
	  https://pubs.opengroup.org/onlinepubs/9699919799/xrat/V4_subprofiles.html

endmenu
```
