## CMakeLists.txt
```
# SPDX-License-Identifier: Apache-2.0

cmake_minimum_required(VERSION 3.20.0)

find_package(Zephyr REQUIRED HINTS $ENV{ZEPHYR_BASE})
project(custom_option_group)

set(app_sources src/main.c)

if(CONFIG_TC_PROVIDES_POSIX_PIPE)
  list(APPEND app_sources src/custom_pipe.c)
endif()

target_sources(app PRIVATE ${app_sources})

target_compile_options(app PRIVATE -D_POSIX_C_SOURCE=200809L)
```

## Kconfig
```
# Copyright (c) 2024, Tenstorrent AI ULC
#
# SPDX-License-Identifier: Apache-2.0

source "Kconfig.zephyr"

config POSIX_PIPE
	bool "Default pipe()"
	help
	  Select 'y' here to use the default pipe() implementation.

config CUSTOM_PIPE
	bool "Custom pipe()"
	select TC_PROVIDES_POSIX_PIPE
	help
	  Select 'y' here to use the custom pipe() implementation.
```

## sample.yaml
```
sample:
  description: Custom POSIX Option Group Implementation
  name: custom_option_group
common:
  filter: not CONFIG_NATIVE_LIBC
  harness: console
  tags:
    - posix
  platform_exclude:
    - native_posix
    - native_posix/native/64
tests:
  sample.posix.custom_option_group.normal:
    harness_config:
      type: one_line
      ordered: true
      regex:
        - "write: 42"
        - "read: 42"

  sample.posix.custom_option_group.custom:
    extra_args: OVERLAY_CONFIG=custom.conf
    harness_config:
      type: one_line
      ordered: true
      regex:
        - "write: 42"
        - "this pipe is custom"
        - "read: 42"
```

## prj.conf
```kconfig
CONFIG_POSIX_API=y
CONFIG_POSIX_DEVICE_IO=y
CONFIG_POSIX_PIPE=y
```

## custom.conf
```kconfig
CONFIG_CUSTOM_PIPE=y
```

## src/main.c
```c
/*
 * Copyright (c) 2024, Tenstorrent AI ULC
 *
 * SPDX-License-Identifier: Apache-2.0
 */

#include <stdint.h>
#include <stdio.h>
#include <stdlib.h>
#include <unistd.h>

int main(void)
{
	int ret;
	int fd[2];
	uint8_t buf[1];

	ret = pipe(fd);
	if (ret < 0) {
		perror("pipe");
		goto out;
	}

	ret = write(fd[0], "\x42", 1);
	if (ret != 1) {
		perror("write");
		goto out;
	}
	printf("write: %x\n", 0x42);

	ret = read(fd[1], buf, 1);
	if (ret != 1) {
		perror("read");
		goto out;
	}
	printf("read: %x\n", buf[0]);

out:
	close(fd[0]);
	close(fd[1]);

	return (ret == 0) ? EXIT_SUCCESS : EXIT_FAILURE;
}
```

## src/custom_pipe.c
```c
/*
 * Copyright (c) 2024, Tenstorrent AI ULC
 *
 * SPDX-License-Identifier: Apache-2.0
 */

#include <stddef.h>
#include <stdbool.h>
#include <stdint.h>
#include <stdio.h>

#include <zephyr/sys/fdtable.h>

static uint8_t my_object;

static ssize_t pipe_rw(void *obj, void *buf, size_t size, bool is_write)
{
	ARG_UNUSED(size);

	uint8_t *x = obj;

	if (is_write) {
		*x = *(uint8_t *)buf;
		return 1;
	}

	printf("this pipe is custom\n");
	*(uint8_t *)buf = *x;
	return 1;
}

static ssize_t pipe_read(void *obj, void *buf, size_t size)
{
	return pipe_rw(obj, buf, size, false);
}

static ssize_t pipe_write(void *obj, const void *buf, size_t size)
{
	return pipe_rw(obj, (void *)buf, size, true);
}

static const struct fd_op_vtable pipe_vtable = {
	.read = pipe_read,
	.write = pipe_write,
};

int pipe(int fd[2])
{
	fd[0] = z_alloc_fd(&my_object, &pipe_vtable);
	fd[1] = z_alloc_fd(&my_object, &pipe_vtable);

	return 0;
}
```
