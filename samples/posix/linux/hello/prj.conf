## CMakeLists.txt
```
# SPDX-License-Identifier: Apache-2.0

cmake_minimum_required(VERSION 3.20.0)

find_package(Zephyr REQUIRED HINTS $ENV{ZEPHYR_BASE})
project(linux_hello)

target_sources(app PRIVATE src/main.c)
target_include_directories(app PRIVATE ${ZEPHYR_BINARY_DIR}/include/generated)

# Note: assume the host is Ubuntu, a cross-toolchain can be installed with:
# sudo apt install -y crossbuild-essential-riscv64

if(CONFIG_RISCV)
  set(CROSS_COMPILE riscv64-linux-gnu-)
  set(CXXFLAGS
    # general optimization flags for size
    -nostdlib -nostartfiles -static -g -Oz
    # Use the musl libc (produces generally smaller binaries than glibc)
    -mmusl
    # machine specific flags
    -mcmodel=medany -mabi=lp64d -march=rv64gc_zicntr
    # remove
    -Wl,--build-id=none
    # needs to have no undefined symbols if we are to execute
    -Wl,--no-undefined
    # remove unused sections (can also done with strip later)
    -Wl,--gc-sections
  )
endif()

set(hello_c ${CMAKE_CURRENT_SOURCE_DIR}/src/hello.c)
set(hello_elf ${PROJECT_BINARY_DIR}/hello.elf)
set(hello_elf_stripped ${PROJECT_BINARY_DIR}/hello.elf.stripped)
set(hello_elf_gz ${PROJECT_BINARY_DIR}/hello.elf.gz)
set(hello_inc ${ZEPHYR_BINARY_DIR}/include/generated/hello.inc)

generate_inc_file_for_target(app ${hello_elf} ${hello_inc})

add_custom_target(
  build_hello_elf
  COMMENT "Cross-compiling ${hello_elf} from ${hello_c}"
  COMMAND ${CROSS_COMPILE}gcc ${CXXFLAGS} ${hello_c} -o ${hello_elf}
  DEPENDS ${hello_c}
  BYPRODUCTS ${hello_elf}
  SOURCES ${hello_c}
)

add_custom_target(
  build_hello_elf_stripped
  COMMENT "Stripping ${hello_elf} of symbols and saving to ${hello_elf_stripped}"
  COMMAND ${CROSS_COMPILE}strip --strip-unneeded ${hello_elf} -o ${hello_elf_stripped}
  DEPENDS ${hello_elf}
  BYPRODUCTS ${hello_elf_stripped}
  SOURCES ${hello_elf}
)

add_custom_target(
  build_hello_elf_gz
  COMMENT "Compressing ${hello_elf_stripped} to ${hello_elf_gz}"
  COMMAND cat ${hello_elf_stripped} | gzip -f -9 > ${hello_elf_gz}
  DEPENDS ${hello_elf_stripped}
  BYPRODUCTS ${hello_elf_gz}
  SOURCES ${hello_elf_stripped}
)
```

## sample.yaml
```
sample:
  description: linux hello sample
  name: linux hello
common:
  tags:
    - posix
    - linux
    - hello
  integration_platforms:
    - qemu_riscv64
  harness: console
  harness_config:
    type: single_line
    regex:
      - "Hello world!"
tests:
  sample.posix.linux.hello: {}
```

## prj.conf
```kconfig
CONFIG_LOG=y
CONFIG_LLEXT=y
CONFIG_POSIX_API=y

CONFIG_LLEXT_LOG_LEVEL_DBG=y
```

## src/main.c
```c
#include <stddef.h>
#include <stdint.h>
#include <stdio.h>

#include <zephyr/llext/llext.h>
#include <zephyr/llext/buf_loader.h>
#include <zephyr/logging/log.h>
#include <zephyr/sys/util.h>

LOG_MODULE_REGISTER(hello_linux);

static const uint8_t hello[] = {
#include "hello.inc"
};

int main(void)
{
	int ret;
	struct llext *ext;
	struct llext_load_param param = LLEXT_LOAD_PARAM_DEFAULT;
	struct llext_buf_loader loader = LLEXT_BUF_LOADER(hello, ARRAY_SIZE(hello));

	LOG_INF("sizeof(hello): %zu", sizeof(hello));

	ret = llext_load(&loader.loader, "ext", &ext, &param);
	if (ret < 0) {
		LOG_ERR("%s() failed: %d", "llext_load", ret);
		return ret;
	}

	k_sleep(K_MSEC(100));

	typedef void (*voidfun_t)(void);

	// dirty hack in terms of entry point, obtained with (load_addr + (&_start - &syscall))
	// riscv64-linux-gnu-objdump -D build/hello.elf | less
	voidfun_t start_fn = (voidfun_t)((intptr_t)0x80010580 + (0x10106 - 0x100e8));
	//voidfun_t main_fn = llext_find_sym(&ext->exp_tab, "_start");

	if (start_fn == NULL) {
		LOG_ERR("%s() failed: %d", "llext_find_sym", -1);
		return -1;
	}

	start_fn();

	return llext_unload(&ext);
}
```

## src/hello.c
```c
#include <stdio.h>
#if 0
int main(int argc, char **argv)
{
	return printf("Hello, world!\n");
}
#else
#include <unistd.h>

#ifndef SYS_write
#define SYS_write 64
#endif

#ifndef SYS_exit
#define SYS_exit 93
#endif

long syscall(long num, ...)
{
	long ret;

	__asm__ volatile (
		"mv a7, %0\n"
		"ecall\n"
		: "=r"(ret)
		: "r"(num)
		: "a0", "a1", "a2", "a3", "a4", "a5", "a6", "a7", "memory"
	);

	return ret;
}

void _start() {
    const char msg[] = "Hello World!\n";
    const int len = sizeof(msg) - 1; // Exclude null terminator
    syscall(SYS_write, 1, msg, len); // SYS_write is the syscall number for write
    syscall(SYS_exit, 0); // SYS_exit is the syscall number for exit
}
#endif
```
