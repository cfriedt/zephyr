/*
 * Copyright (c) 2025 Tenstorrent AI ULC
 *
 * SPDX-License-Identifier: Apache-2.0
 */

/*
 * west build -p auto -b nucleo_g071rb samples/drivers/jesd216/
 * west flash -r openocd --cmd-pre-init "adapter serial 066AFF30304B4E3043034938"
 */

&spi1 {
	pinctrl-0 = <&spi1_nss_pb0 &spi1_sck_pa5
			 &spi1_miso_pa6 &spi1_mosi_pa7>;
	pinctrl-names = "default";
	status = "okay";

	flash1: flash@0 {
		/* base properties */
		compatible = "jedec,spi-nor";
		status = "okay";

		/* cs-gpios = <&gpioa 4 GPIO_ACTIVE_LOW>; */

		/* spi-device properties */
		reg = <0>;
		spi-max-frequency = <31999999>;
		spi-cpol;
		spi-cpha;

		/* jedec,spi-nor properties */
		size = <DT_SIZE_M(16)>; /* Size in bits */

		/* jedec,spi-nor-common properties */
		has-dpd;
		t-enter-dpd = <3000>;
		t-exit-dpd = <30000>;
		jedec-id = [ef 40 15];
	};
};
