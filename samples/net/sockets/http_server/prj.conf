## CMakeLists.txt
```
# SPDX-License-Identifier: Apache-2.0

cmake_minimum_required(VERSION 3.20.0)
find_package(Zephyr REQUIRED HINTS $ENV{ZEPHYR_BASE})
project(http_server)

FILE(GLOB app_sources src/*.c)
target_sources(app PRIVATE ${app_sources})

set(gen_dir ${ZEPHYR_BINARY_DIR}/include/generated/)
```

## Kconfig
```
# Config options for http2 server sample application

# Copyright (c) 2023, Emna Rekik
# SPDX-License-Identifier: Apache-2.0

mainmenu "HTTP2 server sample application"

config TEST_HTTP_SERVICE_PORT
    int "Port number for http service"
    default 0

source "Kconfig.zephyr"
```

## sample.yaml
```
sample:
  description: HTTP Server Sample
  name: http_server_sample
common:
  harness: net
  min_ram: 32
  tags:
    - http
    - net
    - server
    - socket
  platform_exclude: native_posix_64
tests:
  sample.net.sockets.http.server: {}
```

## prj.conf
```kconfig
# General config
CONFIG_MAIN_STACK_SIZE=1536
CONFIG_NEWLIB_LIBC=y

# Eventfd
CONFIG_EVENTFD=y

# Networking config
CONFIG_NETWORKING=y
CONFIG_NET_IPV4=y
CONFIG_NET_IPV6=y
CONFIG_NET_TCP=y
CONFIG_NET_SOCKETS=y
CONFIG_POSIX_API=y

# HTTP parser
CONFIG_HTTP_PARSER_URL=y
CONFIG_HTTP_PARSER=y
CONFIG_HTTP_HPACK_TABLE=y
CONFIG_HTTP_SERVER=y

# Network driver config
CONFIG_TEST_RANDOM_GENERATOR=y

# Network address config
CONFIG_NET_CONFIG_SETTINGS=y
CONFIG_NET_CONFIG_NEED_IPV4=y
CONFIG_NET_CONFIG_MY_IPV4_ADDR="192.0.2.1"
CONFIG_NET_CONFIG_PEER_IPV4_ADDR="192.0.2.2"
CONFIG_NET_CONFIG_MY_IPV4_GW="192.0.2.2"

# Networking tweaks
# Required to handle large number of consecutive connections,
# e.g. when testing with ApacheBench.
CONFIG_NET_TCP_TIME_WAIT_DELAY=0

# Network debug config
CONFIG_NET_LOG=y

CONFIG_LOG=y
CONFIG_LOG_MODE_MINIMAL=y

CONFIG_HTTP_SERVER=y
CONFIG_NET_CONNECTION_MANAGER=y
```

## src/main.c
```c
/*
 * Copyright (c) 2023, Emna Rekik
 *
 * SPDX-License-Identifier: Apache-2.0
 */

#include <stdio.h>

#include <zephyr/net/http/server.h>
#include <zephyr/net/http/service.h>

#if defined(__ZEPHYR__) || defined(CONFIG_POSIX_API)

#include <zephyr/kernel.h>

#elif defined(__linux__)

#include <netinet/in.h>

#endif

static uint16_t test_http_service_port = htons(CONFIG_TEST_HTTP_SERVICE_PORT);
HTTP_SERVICE_DEFINE(test_http_service, CONFIG_NET_CONFIG_MY_IPV4_ADDR, &test_http_service_port, 1,
		    10, NULL);

static const uint8_t index_html_gz[] = {
#include "index.html.gz.inc"
};
HTTP_RESOURCE_DEFINE(index_html_gz_resource, test_http_service, "/", index_html_gz);

int main(void)
{
	return http_server_start();
}
```
