## prj.conf
```kconfig
CONFIG_ZTEST=y
CONFIG_TEST_USERSPACE=y
CONFIG_ZTEST_FATAL_HOOK=y

CONFIG_THREAD_STACK_INFO=y
CONFIG_DYNAMIC_THREAD=y
CONFIG_DYNAMIC_THREAD_POOL_SIZE=2
CONFIG_COMMON_LIBC_THRD=y
# work around for #91620
CONFIG_MP_MAX_NUM_CPUS=1
CONFIG_MAX_THREAD_BYTES=8

CONFIG_NO_OPTIMIZATIONS=y
```

## src/cnd.c
```c
/*
 * Copyright (c) 2023, Meta
 *
 * SPDX-License-Identifier: Apache-2.0
 */

#include "zephyr/posix/posix_features.h"
#include "thrd.h"

#include <stdint.h>
#include <threads.h>

#include <zephyr/ztest.h>

#define WAIT_TIME_MS 100

static struct libc_cnd_fixture {
	/* shared between threads in tests */
	cnd_t cond;
	mtx_t mutex;

	/* de-duplicate local variables in test cases */
	int res1;
	int res2;
	thrd_t thrd1;
	thrd_t thrd2;
	bool do_timedwait;
	bool is_broadcast;
	struct timespec time_point;
} _libc_cnd_fixture;

ZTEST_F(libc_cnd, test_cnd_init_destroy)
{
	/* degenerate cases */
	if (false) {
		/* pthread_cond_init() pthread_cond_destroy() are not hardened against these */
		zassert_equal(thrd_error, cnd_init(NULL));
		zassert_equal(thrd_error, cnd_init((cnd_t *)BIOS_FOOD));
		cnd_destroy(NULL);
		cnd_destroy((cnd_t *)BIOS_FOOD);
	}

	/* happy path tested in before() / after() */
}

ZTEST_F(libc_cnd, test_cnd_errors)
{
	/* degenerate test cases */
	if (false) {
		/* pthread_cond_*() are not hardened against these */
		zassert_equal(thrd_error, cnd_signal(NULL));
		zassert_equal(thrd_error, cnd_broadcast(NULL));
		zassert_equal(thrd_error, cnd_wait(NULL, NULL));
		zassert_equal(thrd_error, cnd_wait(NULL, &fixture->mutex));
		zassert_equal(thrd_error, cnd_wait(&fixture->cond, NULL));
		zassert_equal(thrd_error, cnd_timedwait(NULL, NULL, NULL));
		zassert_equal(thrd_error, cnd_timedwait(NULL, NULL, &fixture->time_point));
		zassert_equal(thrd_error, cnd_timedwait(NULL, &fixture->mutex, NULL));
		zassert_equal(thrd_error,
			      cnd_timedwait(NULL, &fixture->mutex, &fixture->time_point));
		zassert_equal(thrd_error, cnd_timedwait(&fixture->cond, NULL, NULL));
		zassert_equal(thrd_error,
			      cnd_timedwait(&fixture->cond, NULL, &fixture->time_point));
		zassert_equal(thrd_error, cnd_timedwait(&fixture->cond, &fixture->mutex, NULL));
	}
}

static int test_cnd_thread_fn(void *arg)
{
	int res = thrd_success;
	struct timespec time_point;
	struct libc_cnd_fixture *const fixture = arg;

	if (fixture->do_timedwait) {
		zassume_ok(sys_clock_gettime(SYS_CLOCK_REALTIME, &time_point));
		timespec_add_ms(&time_point, WAIT_TIME_MS);
		res = cnd_timedwait(&fixture->cond, &fixture->mutex, &time_point);
	} else {
		res = cnd_wait(&fixture->cond, &fixture->mutex);
	}

	if (fixture->is_broadcast) {
		/* re-signal so that the next thread wakes up too */
		zassert_equal(thrd_success, cnd_signal(&fixture->cond));
	}

	(void)mtx_unlock(&fixture->mutex);

	return res;
}

static void tst_cnd_common(struct libc_cnd_fixture *fixture, size_t wait_ms, bool th2, int exp1,
			   int exp2)
{
	zassert_equal(thrd_success, mtx_lock(&fixture->mutex));

	zassert_equal(thrd_success, thrd_create(&fixture->thrd1, test_cnd_thread_fn, fixture));
	if (th2) {
		zassert_equal(thrd_success,
			      thrd_create(&fixture->thrd2, test_cnd_thread_fn, fixture));
	}

	k_msleep(wait_ms);

	if (fixture->is_broadcast) {
		zassert_equal(thrd_success, cnd_broadcast(&fixture->cond));
	} else {
		zassert_equal(thrd_success, cnd_signal(&fixture->cond));
	}

	zassert_equal(thrd_success, mtx_unlock(&fixture->mutex));

	zassert_equal(thrd_success, thrd_join(fixture->thrd1, &fixture->res1));
	if (th2) {
		zassert_equal(thrd_success, thrd_join(fixture->thrd2, &fixture->res2));
	}

	zassert_equal(exp1, fixture->res1);
	if (th2) {
		zassert_equal(exp2, fixture->res2);
	}
}

ZTEST_F(libc_cnd, test_cnd_signal_wait)
{
	tst_cnd_common(fixture, WAIT_TIME_MS / 2, false, thrd_success, DONT_CARE);
}

ZTEST_F(libc_cnd, test_cnd_signal_timedwait)
{
	fixture->do_timedwait = true;
	tst_cnd_common(fixture, WAIT_TIME_MS / 2, false, thrd_success, DONT_CARE);
}

ZTEST_F(libc_cnd, test_cnd_timedwait_timeout)
{
	fixture->do_timedwait = true;
	tst_cnd_common(fixture, WAIT_TIME_MS * 2, false, thrd_timedout, DONT_CARE);
}

ZTEST_F(libc_cnd, test_cnd_broadcast_wait)
{
	fixture->is_broadcast = true;
	tst_cnd_common(fixture, WAIT_TIME_MS, true, thrd_success, thrd_success);
}

static void *setup(void)
{
	return &_libc_cnd_fixture;
}

static void before(void *arg)
{
	struct libc_cnd_fixture *const fixture = arg;

	*fixture = (struct libc_cnd_fixture){
		.res1 = FORTY_TWO,
		.res2 = SEVENTY_THREE,
	};

	zassert_equal(thrd_success, mtx_init(&fixture->mutex, mtx_plain));
	zassert_equal(thrd_success, cnd_init(&fixture->cond));
}

static void after(void *arg)
{
	struct libc_cnd_fixture *const fixture = arg;

	cnd_destroy(&fixture->cond);
	mtx_destroy(&fixture->mutex);
}

ZTEST_SUITE(libc_cnd, NULL, setup, before, after, NULL);
```

## src/mtx.c
```c
/*
 * Copyright (c) 2023, Meta
 *
 * SPDX-License-Identifier: Apache-2.0
 */

#include "thrd.h"

#include <stdint.h>
#include <threads.h>

#include <zephyr/sys_clock.h>
#include <zephyr/ztest.h>

static const int valid_mtx_types[] = {
	mtx_plain,
	mtx_timed,
	mtx_plain | mtx_recursive,
	mtx_timed | mtx_recursive,
};

static mtx_t  mutex;
static thrd_t th;

ZTEST(libc_mtx, test_mtx_init)
{
	zassert_not_equal(thrd_success, mtx_init(NULL, FORTY_TWO));
	zassert_not_equal(thrd_success, mtx_init(&mutex, FORTY_TWO));

	if (false) {
		/* pthread_mutexattr_init() is not hardened against this */
		zassert_not_equal(thrd_success, mtx_init(NULL, mtx_plain));
		zassert_not_equal(thrd_success, mtx_init((mtx_t *)BIOS_FOOD, FORTY_TWO));
	}

	for (size_t i = 0; i < ARRAY_SIZE(valid_mtx_types); ++i) {
		int type = valid_mtx_types[i];

		zassert_equal(thrd_success, mtx_init(&mutex, type));
		mtx_destroy(&mutex);
	}
}

ZTEST(libc_mtx, test_mtx_destroy)
{
	if (false) {
		/* degenerate cases */
		/* pthread_mutex_destroy() is not hardened against these */
		mtx_destroy(NULL);
		mtx_destroy((mtx_t *)BIOS_FOOD);
	}

	zassert_equal(thrd_success, mtx_init(&mutex, mtx_plain));
	mtx_destroy(&mutex);
}

ZTEST(libc_mtx, test_mtx_lock)
{
	if (false) {
		/* pthread_mutex_lock() is not hardened against this */
		zassert_not_equal(thrd_success, mtx_lock(NULL));
		zassert_not_equal(thrd_success, mtx_lock((mtx_t *)BIOS_FOOD));
	}

	/* test plain mutex */
	for (size_t i = 0; i < ARRAY_SIZE(valid_mtx_types); ++i) {
		int type = valid_mtx_types[i];

		zassert_equal(thrd_success, mtx_init(&mutex, type));
		zassert_equal(thrd_success, mtx_lock(&mutex));
		if ((type & mtx_recursive) == 0) {
			if (false) {
				/* pthread_mutex_lock() is not hardened against this */
				zassert_not_equal(thrd_success, mtx_lock((&mutex)));
			}
		} else {
			zassert_equal(thrd_success, mtx_lock(&mutex));
			zassert_equal(thrd_success, mtx_unlock(&mutex));
		}
		zassert_equal(thrd_success, mtx_unlock(&mutex));
		mtx_destroy(&mutex);
	}
}

#define TIMEDLOCK_TIMEOUT_MS       200
#define TIMEDLOCK_TIMEOUT_DELAY_MS 100

BUILD_ASSERT(TIMEDLOCK_TIMEOUT_DELAY_MS >= 100, "TIMEDLOCK_TIMEOUT_DELAY_MS too small");
BUILD_ASSERT(TIMEDLOCK_TIMEOUT_MS >= 2 * TIMEDLOCK_TIMEOUT_DELAY_MS,
	     "TIMEDLOCK_TIMEOUT_MS too small");

static int mtx_timedlock_fn(void *arg)
{
	struct timespec time_point;
	mtx_t *mtx = (mtx_t *)arg;

	zassume_ok(sys_clock_gettime(SYS_CLOCK_MONOTONIC, &time_point));
	timespec_add_ms(&time_point, TIMEDLOCK_TIMEOUT_MS);

	return mtx_timedlock(mtx, &time_point);
}

ZTEST(libc_mtx, test_mtx_timedlock)
{
	int ret;

	/*
	 * mtx_timed here is technically unnecessary, because all pthreads can
	 * be used for timed locks, but that is sort of peeking into the
	 * implementation
	 */
	zassert_equal(thrd_success, mtx_init(&mutex, mtx_timed));

	printk("Expecting timedlock with timeout of %d ms to fail\n", TIMEDLOCK_TIMEOUT_MS);
	zassert_equal(thrd_success, mtx_lock(&mutex));
	zassert_equal(thrd_success, thrd_create(&th, mtx_timedlock_fn, &mutex));
	zassert_equal(thrd_success, thrd_join(th, &ret));
	/* ensure timeout occurs */
	zassert_equal(thrd_timedout, ret);

	printk("Expecting timedlock with timeout of %d ms to succeed after 100ms\n",
	       TIMEDLOCK_TIMEOUT_MS);
	zassert_equal(thrd_success, thrd_create(&th, mtx_timedlock_fn, &mutex));
	/* unlock before timeout expires */
	k_msleep(TIMEDLOCK_TIMEOUT_DELAY_MS);
	zassert_equal(thrd_success, mtx_unlock(&mutex));
	zassert_equal(thrd_success, thrd_join(th, &ret));
	/* ensure lock is successful, in spite of delay  */
	zassert_equal(thrd_success, ret);

	mtx_destroy(&mutex);
}

static int mtx_trylock_fn(void *arg)
{
	mtx_t *mtx = (mtx_t *)arg;

	return mtx_trylock(mtx);
}

ZTEST(libc_mtx, test_mtx_trylock)
{
	int ret;

	zassert_equal(thrd_success, mtx_init(&mutex, mtx_plain));

	/* ensure trylock fails when lock is held */
	zassert_equal(thrd_success, mtx_lock(&mutex));
	zassert_equal(thrd_success, thrd_create(&th, mtx_trylock_fn, &mutex));
	zassert_equal(thrd_success, thrd_join(th, &ret));
	/* ensure lock fails */
	zassert_equal(thrd_busy, ret);

	mtx_destroy(&mutex);
}

ZTEST(libc_mtx, test_mtx_unlock)
{
	mtx_t mtx;

	/* degenerate case */
	zassert_not_equal(thrd_success, mtx_unlock(&mtx));

	zassert_equal(thrd_success, mtx_init(&mtx, mtx_plain));
	zassert_equal(thrd_success, mtx_lock(&mtx));
	zassert_equal(thrd_success, mtx_unlock(&mtx));
	mtx_destroy(&mtx);
}

ZTEST_SUITE(libc_mtx, NULL, NULL, NULL, NULL, NULL);
```

## src/thrd.c
```c
/*
 * Copyright (c) 2023, Meta
 *
 * SPDX-License-Identifier: Apache-2.0
 */

#include "thrd.h"

#include <stdint.h>
#include <threads.h>

#include <zephyr/sys_clock.h>
#include <zephyr/sys/timeutil.h>
#include <zephyr/ztest.h>

static thrd_t     thr;
static uintptr_t  param;

#if 0
ZTEST(libc_thrd, test_thrd_sleep)
{
	int64_t end;
	int64_t start;
	struct timespec duration = {0};
	struct timespec remaining;
	const uint16_t delay_ms[] = {0, 100, 200, 400};

	if (false) {
		/* duration may not be NULL */
		zassert_not_equal(thrd_success, thrd_sleep(NULL, NULL));
	}

	zassert_equal(thrd_success, thrd_sleep(&duration, NULL));
	zassert_equal(thrd_success, thrd_sleep(&duration, &duration));

	for (int i = 0; i < ARRAY_SIZE(delay_ms); ++i) {
		timespec_from_timeout(K_MSEC(delay_ms[i]), &duration);
		remaining = (struct timespec){.tv_sec = 4242, .tv_nsec = 4242};

		printk("sleeping %d ms\n", delay_ms[i]);
		start = k_uptime_get();
		zassert_equal(thrd_success, thrd_sleep(&duration, &remaining));
		end = k_uptime_get();
		zassert_equal(remaining.tv_sec, 0);
		zassert_equal(remaining.tv_nsec, 0);
		zassert_true(end - start >= delay_ms[i]);
	}
}
#endif

static int thrd_create_join_fn(void *arg)
{
	uintptr_t *x = (uintptr_t *)arg;

	if (x != NULL) {
		*x = BIOS_FOOD;
	}

	return FORTY_TWO;
}

ZTEST(libc_thrd, test_thrd_create_join)
{
	int res = 0;
	thrd_start_t fun = thrd_create_join_fn;

	param = 0;

	if (false) {
		/* pthread_create() is not hardened for degenerate cases like this */
		zassert_equal(thrd_error, thrd_create(NULL, NULL, NULL));
		zassert_equal(thrd_error, thrd_create(NULL, NULL, &param));
		zassert_equal(thrd_error, thrd_create(NULL, fun, NULL));
		zassert_equal(thrd_error, thrd_create(NULL, fun, &param));
		zassert_equal(thrd_error, thrd_create(&thr, NULL, NULL));
		zassert_equal(thrd_error, thrd_create(&thr, NULL, &param));
	}

	zassert_equal(thrd_success, thrd_create(&thr, fun, NULL));
	zassert_equal(thrd_success, thrd_join(thr, NULL));

	zassert_equal(thrd_success, thrd_create(&thr, fun, &param));
	zassert_equal(thrd_success, thrd_join(thr, &res));
	zassert_equal(BIOS_FOOD, param, "expected: %u actual: %llu", BIOS_FOOD,
		     (unsigned long long)param);
	zassert_equal(FORTY_TWO, res);
}

#if 0
static int thrd_exit_fn(void *arg)
{
	uintptr_t *x = (uintptr_t *)arg;

	*x = BIOS_FOOD;

	thrd_exit(SEVENTY_THREE);

	return FORTY_TWO;

	CODE_UNREACHABLE;
}

ZTEST(libc_thrd, test_thrd_exit)
{
	int res = 0;

	param = 0;

	zassert_equal(thrd_success, thrd_create(&thr, thrd_exit_fn, &param));
	zassert_equal(thrd_success, thrd_join(thr, &res));
	zassert_equal(BIOS_FOOD, param);
	zassert_equal(SEVENTY_THREE, res);
}

ZTEST(libc_thrd, test_thrd_yield)
{
	thrd_yield();
}

static thrd_t child;
static thrd_t parent;

static int thrd_current_equal_fn(void *arg)
{
	ARG_UNUSED(arg);

	zassert_equal(thrd_current(), child);
	zassert_not_equal(child, parent);

	zassert_true(thrd_equal(thrd_current(), child));
	zassert_false(thrd_equal(child, parent));

	return 0;
}

ZTEST(libc_thrd, test_thrd_current_equal)
{
	parent = thrd_current();

	zassert_equal(thrd_success, thrd_create(&child, thrd_current_equal_fn, NULL));
	zassert_equal(thrd_success, thrd_join(child, NULL));
}

static bool detached_thread_is_probably_done;

static int thrd_detach_fn(void *arg)
{
	ARG_UNUSED(arg);

	detached_thread_is_probably_done = true;
	return SEVENTY_THREE;
}

ZTEST(libc_thrd, test_thrd_detach)
{
	zassert_equal(thrd_success, thrd_create(&thr, thrd_detach_fn, NULL));
	zassert_equal(thrd_success, thrd_detach(thr));
	zassert_equal(thrd_error, thrd_join(thr, NULL));

	do {
		k_msleep(100);
	} while (!detached_thread_is_probably_done);

	zassert_equal(thrd_error, thrd_join(thr, NULL));
}

ZTEST(libc_thrd, test_thrd_reuse)
{
	for (int i = 0; i < FORTY_TWO; ++i) {
		zassert_equal(thrd_success, thrd_create(&thr, thrd_create_join_fn, NULL));
		zassert_equal(thrd_success, thrd_join(thr, NULL));
	}
}
#endif

ZTEST_SUITE(libc_thrd, NULL, NULL, NULL, NULL, NULL);
```
