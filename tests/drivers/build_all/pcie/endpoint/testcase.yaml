## tests/drivers/build_all/pcie/endpoint/testcase.yaml
```yaml
common:
  build_only: true
  tags: drivers pcie endpoint
tests:
  pcie.endpoint.build.iproc.dma:
    platform_allow: native_posix
    extra_configs:
      - CONFIG_PCIE_EP_IPROC=y
      - CONFIG_PCIE_EP_IPROC_V2=y
      - CONFIG_DMA=y
      - CONFIG_DMA_EMUL=y
```

## tests/drivers/gpio/gpio_api_1pin/boards/nucleo_g071rb.conf
```kconfig
CONFIG_I2C=y
CONFIG_GPIO_LOG_LEVEL_DBG=y
CONFIG_I2C_LOG_LEVEL_DBG=y

CONFIG_SHELL=y
CONFIG_I2C_SHELL=y
CONFIG_GPIO_SHELL=y
```

## tests/kernel/gen_isr_table/boards/adp_xc7k_ae350.conf
```kconfig
CONFIG_2ND_LEVEL_INTERRUPTS=y
CONFIG_NUM_2ND_LEVEL_AGGREGATORS=1
CONFIG_2ND_LVL_INTR_00_OFFSET=11

# Per PLIC specification
# https://github.com/riscv/riscv-plic-spec/blob/master/riscv-plic.adoc#2-memory-map
CONFIG_MAX_IRQ_PER_AGGREGATOR=1023
```

## tests/kernel/signal/testcase.yaml
```yaml
tests:
  kernel.signals:
    ignore_faults: true
    tags:
      - kernel
      - userspace
```

## tests/kernel/threads/thread_pool/testcase.yaml
```yaml
common:
  tags: kernel threads
  integration_platforms:
    # - qemu_x86
    # - qemu_x86_nommu
    # - qemu_x86_tiny
    # - qemu_x86_virt
    # - qemu_x86_64
    - qemu_cortex_a53
    - qemu_cortex_a53_smp
    - qemu_cortex_m3
    - qemu_riscv32
    - qemu_riscv32e
    - qemu_riscv64
    - qemu_riscv64_smp
tests:
  kernel.threads.pool.kernel:
    extra_configs:
      - CONFIG_USERSPACE=n
  # kernel.threads.pool.userspace:
  #   tags: userspace
  #   extra_configs:
  #     - CONFIG_USERSPACE=y
```

## tests/lib/thrift/ThriftTest/testcase.yaml
```yaml
common:
  tags: thrift cpp
  modules:
    - thrift
  filter: TOOLCHAIN_HAS_NEWLIB == 1
  # qemu_x86 exluded due to missing long double functions in SDK
  # See https://github.com/zephyrproject-rtos/sdk-ng/issues/603
  platform_allow: mps2_an385 qemu_cortex_a53 qemu_riscv32 qemu_riscv64 qemu_x86_64
tests:
  thrift.ThriftTest.newlib.binaryProtocol:
    tags: newlib
  thrift.ThriftTest.newlib.compactProtocol:
    extra_configs:
      - CONFIG_THRIFT_COMPACT_PROTOCOL=y
    tags: newlib
  thrift.ThriftTest.newlib.bufferedTransport:
    tags: newlib
  thrift.ThriftTest.newlib.zlibTransport:
    extra_configs:
      - CONFIG_THRIFT_ZLIB_TRANSPORT=y
      - CONFIG_NEWLIB_LIBC_MAX_MAPPED_REGION_SIZE=4194304
    tags: newlib
  thrift.ThriftTest.newlib.tlsTransport:
    extra_args: OVERLAY_CONFIG="overlay-tls.conf"
    tags: newlib
```

## tests/lib/thrift/muzic/testcase.yaml
```yaml
common:
  tags: thrift zlib
  modules:
    - thrift
  min_ram: 512
tests:
  thrift.zlib:
    integration_platforms:
      - native_posix
```

## tests/posix/eventfd/testcase.yaml
```yaml
tests:
  portability.posix.eventfd:
    min_ram: 32
    tags: posix pthread eventfd
```

## tests/posix/getopt/testcase.yaml
```yaml
tests:
  shell.getopt:
    tags: getopt
    integration_platforms:
      - qemu_x86
    min_flash: 64
    min_ram: 32
    filter: (CONFIG_GETOPT and not CONFIG_NEWLIB_LIBC)
```

## tests/posix/threads_base/testcase.yaml
```yaml
common:
  tags: posix
  min_ram: 64
  timeout: 240
  # 1 tier0 platform per supported architecture
  platform_key:
    - arch
    - simulation
  platform_exclude:
    - native_posix
    - native_posix/native/64
    # consistently overflows flash
    - qemu_nios2
  filter: not CONFIG_NATIVE_LIBC
tests:
  portability.posix.threads.base: {}
  portability.posix.threads.base.minimal:
    extra_configs:
      - CONFIG_MINIMAL_LIBC=y
  portability.posix.threads.base.newlib:
    platform_exclude:
      - intel_ehl_crb
      - lpcxpresso55s06
    filter: TOOLCHAIN_HAS_NEWLIB == 1
    extra_configs:
      - CONFIG_NEWLIB_LIBC=y
  portability.posix.threads.base.armclang_std_libc:
    toolchain_allow: armclang
    extra_configs:
      - CONFIG_ARMCLANG_STD_LIBC=y
  portability.posix.threads.base.arcmwdtlib:
    toolchain_allow: arcmwdt
    extra_configs:
      - CONFIG_ARCMWDT_LIBC=y
  portability.posix.threads.base.tls:
    platform_exclude:
      - intel_ehl_crb
    filter: CONFIG_ARCH_HAS_THREAD_LOCAL_STORAGE and CONFIG_TOOLCHAIN_SUPPORTS_THREAD_LOCAL_STORAGE
    extra_configs:
      - CONFIG_NEWLIB_LIBC=n
      - CONFIG_THREAD_LOCAL_STORAGE=y
  portability.posix.threads.base.tls.newlib:
    platform_exclude:
      - intel_ehl_crb
      - lpcxpresso55s06
    filter: TOOLCHAIN_HAS_NEWLIB == 1 and CONFIG_ARCH_HAS_THREAD_LOCAL_STORAGE and
      CONFIG_TOOLCHAIN_SUPPORTS_THREAD_LOCAL_STORAGE
    extra_configs:
      - CONFIG_NEWLIB_LIBC=y
      - CONFIG_THREAD_LOCAL_STORAGE=y
  portability.posix.threads.base.picolibc:
    tags: picolibc
    filter: CONFIG_PICOLIBC_SUPPORTED
    extra_configs:
      - CONFIG_PICOLIBC=y
  portability.posix.threads.base.no_spin_validate:
    extra_configs:
      - CONFIG_SPIN_VALIDATE=n
  portability.posix.threads.base.signal.strsignal_no_desc:
    extra_configs:
      - CONFIG_POSIX_SIGNAL_STRING_DESC=n
  portability.posix.threads.base.signal.big_nsig:
    extra_configs:
      - CONFIG_POSIX_RTSIG_MAX=1024
  portability.posix.threads.base.dynamic_stack:
    extra_configs:
      - CONFIG_DYNAMIC_THREAD=y
      - CONFIG_THREAD_STACK_INFO=y
      - CONFIG_HEAP_MEM_POOL_SIZE=16384
  portability.posix.threads.base.static_stack:
    extra_configs:
      - CONFIG_DYNAMIC_THREAD=n
      - CONFIG_THREAD_STACK_INFO=n
  portability.posix.threads.base.userspace:
    filter: CONFIG_ARCH_HAS_USERSPACE
    tags:
      - userspace
    extra_configs:
      - CONFIG_USERSPACE=y
```

## tests/posix/xsi_realtime_threads/testcase.yaml
```yaml
common:
  filter: not CONFIG_NATIVE_LIBC
  tags:
    - posix
    - xsi_realtime_threads
  # 1 tier0 platform per supported architecture
  platform_key:
    - arch
    - simulation
  integration_platforms:
    - native_posix
    - qemu_x86_64
    - qemu_cortex_m0
  min_flash: 64
  min_ram: 32  
tests:
  portability.posix.xsi_realtime_threads: {}
  portability.posix.xsi_realtime_threads.minimal:
    extra_configs:
      - CONFIG_MINIMAL_LIBC=y
  portability.posix.xsi_realtime_threads.newlib:
    filter: TOOLCHAIN_HAS_NEWLIB == 1
    extra_configs:
      - CONFIG_NEWLIB_LIBC=y
  portability.posix.xsi_realtime_threads.picolibc:
    tags: picolibc
    filter: CONFIG_PICOLIBC_SUPPORTED
    extra_configs:
      - CONFIG_PICOLIBC=y
```
