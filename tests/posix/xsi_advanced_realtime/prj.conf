## prj.conf
```kconfig
CONFIG_POSIX_API=y
CONFIG_ZTEST=y

CONFIG_POSIX_AEP_CHOICE_BASE=y
CONFIG_XSI_ADVANCED_REALTIME=y

CONFIG_FILE_SYSTEM=y
CONFIG_POSIX_FILE_SYSTEM=y
CONFIG_FAT_FILESYSTEM_ELM=y
CONFIG_MAIN_STACK_SIZE=4096
CONFIG_ZTEST_STACK_SIZE=2048
CONFIG_DYNAMIC_THREAD=y
CONFIG_THREAD_STACK_INFO=y
CONFIG_DYNAMIC_THREAD_POOL_SIZE=6
```

## src/_main.c
```c
/*
 * Copyright (c) 2025 Tenstorrent AI ULC
 *
 * SPDX-License-Identifier: Apache-2.0
 */

#include "_main.h"

#include <fcntl.h>
#include <unistd.h>

#include <ff.h>
#include <zephyr/fs/fs.h>
#include <zephyr/ztest.h>

int fd;

static FATFS fat_fs;

static struct fs_mount_t fatfs_mnt = {
	.type = FS_FATFS,
	.mnt_point = FATFS_MNTP,
	.fs_data = &fat_fs,
};

static void test_mount(void *arg)
{
	int res;

	ARG_UNUSED(arg);

	fd = -1;
	res = fs_mount(&fatfs_mnt);
	zassert_ok(res, "Error mounting fs [%d]\n", res);
}

static void test_unmount(void *arg)
{
	int res;

	ARG_UNUSED(arg);

	if (fd >= 0) {
		res = close(fd);
		__ASSERT(res == 0, "Error closing file [%d]", res);
		fd = -1;
	}

	res = fs_unmount(&fatfs_mnt);
	__ASSERT(res == 0, "Error unmounting fs [%d]", res);
}

ZTEST_SUITE(xsi_advanced_realtime, NULL, NULL, test_mount, test_unmount, NULL);
```

## src/_main.h
```c
/*
 * Copyright (c) 2025 Tenstorrent AI ULC
 *
 * SPDX-License-Identifier: Apache-2.0
 */

#ifndef ZEPHYR_TESTS_POSIX_XSI_ADVANCED_REALTIME_SRC__MAIN_H_
#define ZEPHYR_TESTS_POSIX_XSI_ADVANCED_REALTIME_SRC__MAIN_H_

#include <zephyr/posix/posix_features.h>
#include <zephyr/posix/posix_types.h>

#define FATFS_MNTP "/RAM:"
#define TEST_FILE  FATFS_MNTP "/testfile.txt"

extern int fd;

#endif /* ZEPHYR_TESTS_POSIX_XSI_ADVANCED_REALTIME_SRC__MAIN_H_ */
```

## src/advisory_info.c
```c
/*
 * Copyright (c) 2025 Tenstorrent AI ULC
 *
 * SPDX-License-Identifier: Apache-2.0
 */

#include "_main.h"

#include <errno.h>
#include <fcntl.h>
#include <stdlib.h>
#include <sys/mman.h>
#include <sys/stat.h>
#include <unistd.h>

#include <zephyr/ztest.h>

ZTEST(xsi_advanced_realtime, test_posix_fadvise)
{
	int ret;
	static const uint8_t valid_fadv[] = {
		POSIX_FADV_DONTNEED, POSIX_FADV_NOREUSE,    POSIX_FADV_NORMAL,
		POSIX_FADV_RANDOM,   POSIX_FADV_SEQUENTIAL, POSIX_FADV_WILLNEED,
	};

	fd = open(TEST_FILE, O_RDWR | O_CREAT | O_TRUNC, 0600);
	zassert_not_equal(fd, -1, "%s() failed: %d", "open", errno);

	{
		/* degenerate cases */
		zexpect_not_ok(posix_fadvise(-1, -1, -1, -1));
		zexpect_not_ok(posix_fadvise(-1, -1, -1, POSIX_FADV_DONTNEED));
		zexpect_not_ok(posix_fadvise(-1, -1, 0, -1));
		zexpect_not_ok(posix_fadvise(-1, -1, 0, POSIX_FADV_NOREUSE));
		zexpect_not_ok(posix_fadvise(-1, 0, -1, -1));
		zexpect_not_ok(posix_fadvise(-1, 0, -1, POSIX_FADV_NORMAL));
		zexpect_not_ok(posix_fadvise(-1, 0, 0, -1));
		zexpect_not_ok(posix_fadvise(-1, 0, 0, POSIX_FADV_RANDOM));
		zexpect_not_ok(posix_fadvise(fd, -1, -1, -1));
		zexpect_not_ok(posix_fadvise(fd, -1, -1, POSIX_FADV_SEQUENTIAL));
		zexpect_not_ok(posix_fadvise(fd, -1, 0, -1));
		zexpect_not_ok(posix_fadvise(fd, -1, 0, POSIX_FADV_WILLNEED));
		zexpect_not_ok(posix_fadvise(fd, 0, -1, -1));
		zexpect_not_ok(posix_fadvise(fd, 0, -1, POSIX_FADV_DONTNEED));
		zexpect_not_ok(posix_fadvise(fd, 0, 0, -1));
	}

	ARRAY_FOR_EACH_PTR(valid_fadv, fadv) {
		ret = posix_fadvise(fd, 0, 0, *fadv);
		zexpect_ok(ret, "%s() failed: %d", "posix_fadvise", ret);
	}
}

ZTEST(xsi_advanced_realtime, test_posix_fallocate)
{
	struct stat st = {0};

	fd = open(TEST_FILE, O_RDWR | O_CREAT | O_TRUNC, 0600);
	zassert_not_equal(fd, -1, "%s() failed: %d", "open", errno);

	{
		/* degenerate cases */
		zexpect_not_ok(posix_fallocate(-1, -1, -1));
		zexpect_not_ok(posix_fallocate(-1, -1, 0));
		zexpect_not_ok(posix_fallocate(-1, 0, -1));
		zexpect_not_ok(posix_fallocate(-1, 0, 0));
		zexpect_not_ok(posix_fallocate(fd, -1, -1));
		zexpect_not_ok(posix_fallocate(fd, -1, 0));
		zexpect_not_ok(posix_fallocate(fd, 0, -1));
	}

	/* allocate space */
	zexpect_ok(posix_fallocate(fd, 0, 32));
	zassume_ok(fsync(fd));

	zassume_ok(stat(TEST_FILE, &st));
	zexpect_equal(st.st_size, 32);

	/* deallocate space */
	zexpect_ok(ftruncate(fd, 0));
	zassume_ok(fsync(fd));

	zassume_ok(stat(TEST_FILE, &st));
	zexpect_equal(st.st_size, 0);
}

#pragma GCC diagnostic push
#pragma GCC diagnostic ignored "-Wnonnull"

ZTEST(xsi_advanced_realtime, test_posix_memalign)
{
	void *memptr = NULL;

	{
		/* degenerate cases */
		if (false) {
			/* causes a crash in at least one libc */
			zexpect_not_ok(posix_memalign(NULL, 0, 0));
			zexpect_not_ok(posix_memalign(NULL, 0, 8));
			zexpect_not_ok(posix_memalign(NULL, 8, 0));
			zexpect_not_ok(posix_memalign(NULL, 8, 8));
			zexpect_not_ok(posix_memalign(&memptr, 0, 0));
			zexpect_not_ok(posix_memalign(&memptr, 0, 8));
			zexpect_not_ok(posix_memalign(&memptr, 8, 0));
		}
	}

	zexpect_ok(posix_memalign(&memptr, 8, 8));
	zexpect_not_equal(memptr, NULL);
	zexpect_equal((uintptr_t)memptr % 8, 0);
	if (memptr != NULL) {
		free(memptr);
	}
}

#pragma GCC diagnostic pop

ZTEST(xsi_advanced_realtime, test_posix_madvise)
{
	int ret;
	static uint32_t buf[4];
	static const uint8_t valid_advice[] = {
		POSIX_MADV_DONTNEED,   POSIX_MADV_NORMAL,   POSIX_MADV_RANDOM,
		POSIX_MADV_SEQUENTIAL, POSIX_MADV_WILLNEED,
	};

	{
		/* degenerate cases */
		zexpect_not_ok(posix_madvise(NULL, 0, -1));
		zexpect_not_ok(posix_madvise(NULL, 0, POSIX_MADV_DONTNEED));
		zexpect_not_ok(posix_madvise(NULL, sizeof(buf), -1));
		zexpect_not_ok(posix_madvise(NULL, sizeof(buf), POSIX_MADV_NORMAL));
		zexpect_not_ok(posix_madvise(buf, 0, -1));
		zexpect_not_ok(posix_madvise(buf, 0, POSIX_MADV_RANDOM));
		zexpect_not_ok(posix_madvise(buf, sizeof(buf), -1));
	}

	ARRAY_FOR_EACH_PTR(valid_advice, advice) {
		ret = posix_madvise(buf, sizeof(buf), *advice);
		zexpect_ok(ret, "%s() failed: %d", "posix_madvise", ret);
	}
}
```

## src/cputime.c
```c
/*
 * Copyright (c) 2025 Tenstorrent AI ULC
 *
 * SPDX-License-Identifier: Apache-2.0
 */

#include "_main.h"

#include <errno.h>
#include <fcntl.h>
#include <sys/stat.h>
#include <time.h>
#include <unistd.h>

#include <zephyr/ztest.h>

ZTEST(xsi_advanced_realtime, test_posix_cputime)
{
	clockid_t clock_id;
	struct timespec ts = {0};

	{
		/* degenerate cases */
		zexpect_not_ok(clock_getcpuclockid(-1, NULL));
		zexpect_not_ok(clock_getcpuclockid(-1, &clock_id));
		zexpect_not_ok(clock_getcpuclockid(0, NULL));
	}

	clock_id = -1;
	zexpect_ok(clock_getcpuclockid(0, &clock_id));
	zexpect_not_equal(clock_id, -1);

	zexpect_ok(clock_gettime(clock_id, &ts));
}
```

## src/spawn.c
```c
/*
 * Copyright (c) 2025 Tenstorrent AI ULC
 *
 * SPDX-License-Identifier: Apache-2.0
 */

#include "_main.h"

#include <errno.h>
#include <fcntl.h>
#include <spawn.h>

#include <zephyr/ztest.h>

ZTEST(xsi_advanced_realtime, test_posix_spawn)
{
	/* int posix_spawn(pid_t *restrict pid, const char *restrict path,
       const posix_spawn_file_actions_t *file_actions,
       const posix_spawnattr_t *restrict attrp,
       char *const argv[restrict], char *const envp[restrict]); */

	pid_t pid = 0;
	const char *path = EXE_FILE;
	const posix_spawn_file_actions_t *file_actions = NULL;
	posix_spawnattr_t *attr = NULL;

	zexpect_ok(posix_spawn(NULL, NULL, NULL, NULL, NULL, NULL));
}

ZTEST(xsi_advanced_realtime, test_posix_spawn_file_actions_addclose)
{
	zexpect_ok(posix_spawn_file_actions_addclose(NULL, 0));
}

ZTEST(xsi_advanced_realtime, test_posix_spawn_file_actions_adddup2)
{
	zexpect_ok(posix_spawn_file_actions_adddup2(NULL, 0, 1));
}

ZTEST(xsi_advanced_realtime, test_posix_spawn_file_actions_addopen)
{
	zexpect_ok(posix_spawn_file_actions_addopen(NULL, 0, "file", O_RDONLY, 0));
}

ZTEST(xsi_advanced_realtime, test_posix_spawn_file_actions_destroy)
{
	zexpect_ok(posix_spawn_file_actions_destroy(NULL));
}

ZTEST(xsi_advanced_realtime, test_posix_spawn_file_actions_init)
{
	zexpect_ok(posix_spawn_file_actions_init(NULL));
}

ZTEST(xsi_advanced_realtime, test_posix_spawnattr_destroy)
{
	zexpect_ok(posix_spawnattr_destroy(NULL));
}

ZTEST(xsi_advanced_realtime, test_posix_spawnattr_getflags)
{
	zexpect_ok(posix_spawnattr_getflags(NULL, NULL));
}

ZTEST(xsi_advanced_realtime, test_posix_spawnattr_getpgroup)
{
	zexpect_ok(posix_spawnattr_getpgroup(NULL, NULL));
}

ZTEST(xsi_advanced_realtime, test_posix_spawnattr_getschedparam)
{
	zexpect_ok(posix_spawnattr_getschedparam(NULL, NULL));
}

ZTEST(xsi_advanced_realtime, test_posix_spawnattr_getschedpolicy)
{
	zexpect_ok(posix_spawnattr_getschedpolicy(NULL, NULL));
}

ZTEST(xsi_advanced_realtime, test_posix_spawnattr_getsigdefault)
{
	zexpect_ok(posix_spawnattr_getsigdefault(NULL, NULL));
}

ZTEST(xsi_advanced_realtime, test_posix_spawnattr_getsigmask)
{
	zexpect_ok(posix_spawnattr_getsigmask(NULL, NULL));
}

ZTEST(xsi_advanced_realtime, test_posix_spawnattr_init)
{
	zexpect_ok(posix_spawnattr_init(NULL));
}

ZTEST(xsi_advanced_realtime, test_posix_spawnattr_setflags)
{
	zexpect_ok(posix_spawnattr_setflags(NULL, 0));
}

ZTEST(xsi_advanced_realtime, test_posix_spawnattr_setpgroup)
{
	zexpect_ok(posix_spawnattr_setpgroup(NULL, 0));
}

ZTEST(xsi_advanced_realtime, test_posix_spawnattr_setschedparam)
{
	zexpect_ok(posix_spawnattr_setschedparam(NULL, NULL));
}

ZTEST(xsi_advanced_realtime, test_posix_spawnattr_setschedpolicy)
{
	zexpect_ok(posix_spawnattr_setschedpolicy(NULL, 0));
}

ZTEST(xsi_advanced_realtime, test_posix_spawnattr_setsigdefault)
{
	zexpect_ok(posix_spawnattr_setsigdefault(NULL, NULL));
}

ZTEST(xsi_advanced_realtime, test_posix_spawnattr_setsigmask)
{
	zexpect_ok(posix_spawnattr_setsigmask(NULL, NULL));
}

ZTEST(xsi_advanced_realtime, test_posix_spawnp)
{
	zexpect_ok(posix_spawnp(NULL, NULL, NULL, NULL, NULL, NULL));
}
```

## src/typed_memory_objects.c
```c
/*
 * Copyright (c) 2025 Tenstorrent AI ULC
 *
 * SPDX-License-Identifier: Apache-2.0
 */

#include "_main.h"

#include <errno.h>
#include <fcntl.h>
#include <sys/mman.h>
#include <sys/stat.h>
#include <unistd.h>

#include <zephyr/ztest.h>

ZTEST(xsi_advanced_realtime, test_posix_mem_offset)
{
	/* int posix_mem_offset(const void *ZRESTRICT addr, size_t len, off_t *ZRESTRICT off,
			 size_t *ZRESTRICT contig_len, int *ZRESTRICT fildes); */

	{
		/* degenerate cases */
		zexpect_not_ok(posix_mem_offset(NULL, 0, NULL, NULL, NULL));
	}

	zexpect_ok(posix_mem_offset(NULL, 0, NULL, NULL, NULL));
}

ZTEST(xsi_advanced_realtime, test_posix_typed_mem_get_info)
{
	/* int posix_typed_mem_get_info(int fildes,
	   struct posix_typed_mem_info *info); */

	{
		/* degenerate cases */
		zexpect_not_ok(posix_typed_mem_get_info(-1, NULL));
	}

	zexpect_ok(posix_typed_mem_get_info(-1, NULL));
}

ZTEST(xsi_advanced_realtime, test_posix_typed_mem_open)
{
	/* int posix_typed_mem_open(const char *name, int oflag, int tflag); */

	{
		/* degenerate cases */
		zexpect_not_ok(posix_typed_mem_get_info(-1, NULL));
	}

	zexpect_ok(posix_typed_mem_get_info(-1, NULL));
}
```
