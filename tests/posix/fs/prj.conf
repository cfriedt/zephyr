## prj.conf
```kconfig
CONFIG_FILE_SYSTEM=y
CONFIG_LOG=y
CONFIG_FAT_FILESYSTEM_ELM=y
CONFIG_POSIX_API=y
CONFIG_POSIX_FILE_SYSTEM=y
CONFIG_POSIX_FILE_SYSTEM_R=y
CONFIG_ZTEST=y
CONFIG_MAIN_STACK_SIZE=4096
CONFIG_ZTEST_STACK_SIZE=2048
CONFIG_EVENTFD=n

CONFIG_NO_OPTIMIZATIONS=y
CONFIG_DEBUG_INFO=y

CONFIG_MAIN_STACK_SIZE=4096
CONFIG_IDLE_STACK_SIZE=512
CONFIG_ISR_STACK_SIZE=2048
CONFIG_TEST_EXTRA_STACK_SIZE=1536
CONFIG_SYSTEM_WORKQUEUE_STACK_SIZE=4096
CONFIG_ZTEST_STACK_SIZE=4096
CONFIG_PRIVILEGED_STACK_SIZE=2048
```

## src/test_fs.h
```c
/*
 * Copyright (c) 2018 Intel Corporation.
 *
 * SPDX-License-Identifier: Apache-2.0
 */

#include <zephyr/ztest.h>

#define FATFS_MNTP	"/RAM:"
#define TEST_ROOT	FATFS_MNTP"/"
#define TEST_FILE	FATFS_MNTP"/testfile.txt"
#define TEST_DIR	FATFS_MNTP"/testdir"
#define TEST_DIR_FILE	FATFS_MNTP"/testdir/testfile.txt"
#define TEST_FILE_CONTENTS "Hello, world!\n"

extern const char test_str[];

void *test_mount(void);
void test_unmount(void *unused);
```

## src/test_fs_file.c
```c
/*
 * Copyright (c) 2018 Intel Corporation.
 *
 * SPDX-License-Identifier: Apache-2.0
 */

#include <string.h>
#include <fcntl.h>
#include <zephyr/posix/unistd.h>
#include "test_fs.h"

const char test_str[] = "hello world!";
int file = -1;

static int test_file_open(void)
{
	int res;

	res = open(TEST_FILE, O_CREAT | O_RDWR, 0660);
	if (res < 0) {
		TC_ERROR("Failed opening file: %d, errno=%d\n", res, errno);
		/* FIXME: restructure tests as per #46897 */
		__ASSERT_NO_MSG(res >= 0);
	}

	file = res;

	return TC_PASS;
}

int test_file_write(void)
{
	ssize_t brw;
	off_t res;

	res = lseek(file, 0, SEEK_SET);
	if (res != 0) {
		TC_PRINT("lseek failed [%d]\n", (int)res);
		close(file);
		file = -1;
		return TC_FAIL;
	}

	brw = write(file, (char *)test_str, strlen(test_str));
	if (brw < 0) {
		TC_PRINT("Failed writing to file [%d]\n", (int)brw);
		close(file);
		file = -1;
		return TC_FAIL;
	}

	if (brw < strlen(test_str)) {
		TC_PRINT("Unable to complete write. Volume full.\n");
		TC_PRINT("Number of bytes written: [%d]\n", (int)brw);
		close(file);
		file = -1;
		return TC_FAIL;
	}

	return res;
}

static int test_file_read(void)
{
	ssize_t brw;
	off_t res;
	char read_buff[80];
	size_t sz = strlen(test_str);

	res = lseek(file, 0, SEEK_SET);
	if (res != 0) {
		TC_PRINT("lseek failed [%d]\n", (int)res);
		close(file);
		file = -1;
		return TC_FAIL;
	}

	brw = read(file, read_buff, sz);
	if (brw < 0) {
		TC_PRINT("Failed reading file [%d]\n", (int)brw);
		close(file);
		file = -1;
		return TC_FAIL;
	}

	read_buff[brw] = 0;

	if (strcmp(test_str, read_buff)) {
		TC_PRINT("Error - Data read does not match data written\n");
		TC_PRINT("Data read:\"%s\"\n\n", read_buff);
		return TC_FAIL;
	}

	/* Now test after non-zero lseek. */

	res = lseek(file, 2, SEEK_SET);
	if (res != 2) {
		TC_PRINT("lseek failed [%d]\n", (int)res);
		close(file);
		file = -1;
		return TC_FAIL;
	}

	brw = read(file, read_buff, sizeof(read_buff));
	if (brw < 0) {
		TC_PRINT("Failed reading file [%d]\n", (int)brw);
		close(file);
		file = -1;
		return TC_FAIL;
	}

	/* Check for array overrun */
	brw = (brw < 80) ? brw : brw - 1;

	read_buff[brw] = 0;

	if (strcmp(test_str + 2, read_buff)) {
		TC_PRINT("Error - Data read does not match data written\n");
		TC_PRINT("Data read:\"%s\"\n\n", read_buff);
		return TC_FAIL;
	}

	return TC_PASS;
}

static int test_file_close(void)
{
	int res = 0;

	if (file >= 0) {
		res = close(file);
		if (res < 0) {
			TC_ERROR("Failed closing file: %d, errno=%d\n", res, errno);
			/* FIXME: restructure tests as per #46897 */
			__ASSERT_NO_MSG(res == 0);
		}

		file = -1;
	}

	return res;
}

static int test_file_fsync(void)
{
	int res = 0;

	if (file < 0) {
		return res;
	}

	res = fsync(file);
	if (res < 0) {
		TC_ERROR("Failed to sync file: %d, errno = %d\n", res, errno);
		res = TC_FAIL;
	}

	close(file);
	file = -1;
	return res;
}

#ifdef CONFIG_POSIX_SYNCHRONIZED_IO
static int test_file_fdatasync(void)
{
	int res = 0;

	if (file < 0) {
		return res;
	}

	res = fdatasync(file);
	if (res < 0) {
		TC_ERROR("Failed to sync file: %d, errno = %d\n", res, errno);
		res = TC_FAIL;
	}

	close(file);
	file = -1;
	return res;
}
#endif /* CONFIG_POSIX_SYNCHRONIZED_IO */

static int test_file_truncate(void)
{
	int res = 0;
	size_t truncate_size = sizeof(test_str) - 4;

	if (file < 0) {
		return res;
	}

	res = ftruncate(file, truncate_size);
	if (res) {
		TC_PRINT("Error truncating file [%d]\n", res);
		res = TC_FAIL;
	}

	close(file);
	file = -1;
	return res;
}

static int test_file_delete(void)
{
	int res;

	res = unlink(TEST_FILE);
	if (res) {
		TC_PRINT("Error deleting file [%d]\n", res);
		return res;
	}

	return res;
}

static void after_fn(void *unused)
{
	ARG_UNUSED(unused);

	test_file_close();
	unlink(TEST_FILE);
}

ZTEST_SUITE(posix_fs_file_test, NULL, test_mount, NULL, after_fn,
	    test_unmount);

/**
 * @brief Test for POSIX open API
 *
 * @details Test opens new file through POSIX open API.
 */
ZTEST(posix_fs_file_test, test_fs_open)
{
	/* FIXME: restructure tests as per #46897 */
	zassert_true(test_file_open() == TC_PASS);
}

/**
 * @brief Test for POSIX write API
 *
 * @details Test writes some data through POSIX write API.
 */
ZTEST(posix_fs_file_test, test_fs_write)
{
	/* FIXME: restructure tests as per #46897 */
	zassert_true(test_file_open() == TC_PASS);
	zassert_true(test_file_write() == TC_PASS);
}

/**
 * @brief Test for POSIX write API
 *
 * @details Test reads data back through POSIX read API.
 */
ZTEST(posix_fs_file_test, test_fs_read)
{
	/* FIXME: restructure tests as per #46897 */
	zassert_true(test_file_open() == TC_PASS);
	zassert_true(test_file_write() == TC_PASS);
	zassert_true(test_file_read() == TC_PASS);
}

/**
 * @brief Test for POSIX fsync API
 *
 * @details Test sync the file through POSIX fsync API.
 */
ZTEST(posix_fs_file_test, test_fs_sync)
{
	/* FIXME: restructure tests as per #46897 */
	zassert_true(test_file_open() == TC_PASS);
	zassert_true(test_file_write() == TC_PASS);
	zassert_true(test_file_fsync() == TC_PASS);
}

/**
 * @brief Test for POSIX fdatasync API
 *
 * @details Test sync the file through POSIX fdatasync API.
 */
ZTEST(posix_fs_file_test, test_fs_datasync)
{
#ifdef CONFIG_POSIX_SYNCHRONIZED_IO
	/* FIXME: restructure tests as per #46897 */
	zassert_true(test_file_open() == TC_PASS);
	zassert_true(test_file_write() == TC_PASS);
	zassert_true(test_file_fdatasync() == TC_PASS);
#else
	ztest_test_skip();
#endif
}

/**
 * @brief Test for POSIX ftruncate API
 *
 * @details Test truncate the file through POSIX ftruncate API.
 */
ZTEST(posix_fs_file_test, test_fs_truncate)
{
	/* FIXME: restructure tests as per #46897 */
	zassert_true(test_file_open() == TC_PASS);
	zassert_true(test_file_write() == TC_PASS);
	zassert_true(test_file_truncate() == TC_PASS);
}

/**
 * @brief Test for POSIX close API
 *
 * @details Test closes the open file through POSIX close API.
 */
ZTEST(posix_fs_file_test, test_fs_close)
{
	/* FIXME: restructure tests as per #46897 */
	zassert_true(test_file_open() == TC_PASS);
	zassert_true(test_file_close() == TC_PASS);
}

/**
 * @brief Test for POSIX unlink API
 *
 * @details Test deletes a file through POSIX unlink API.
 */
ZTEST(posix_fs_file_test, test_fs_unlink)
{
	zassert_true(test_file_open() == TC_PASS);
	zassert_true(test_file_delete() == TC_PASS);
}

ZTEST(posix_fs_file_test, test_fs_fd_leak)
{
	const int reps =
	    MAX(CONFIG_POSIX_OPEN_MAX, CONFIG_ZVFS_OPEN_MAX) + 5;

	for (int i = 0; i < reps; i++) {
		if (i > 0) {
			zassert_true(test_file_open() == TC_PASS);
		}

		if (i < reps - 1) {
			zassert_true(test_file_close() == TC_PASS);
		}
	}
}

ZTEST(posix_fs_file_test, test_file_open_truncate)
{
	struct stat buf = {0};

	zassert_ok(test_file_open());
	zassert_ok(test_file_write());
	zassert_ok(test_file_close());
	file = open(TEST_FILE, O_RDWR | O_TRUNC);
	zassert_not_equal(file, -1,
			  "File open failed for truncate mode");

	zassert_ok(test_file_close());
	zassert_ok(stat(TEST_FILE, &buf));
	zassert_equal(buf.st_size, 0, "Error: file is not truncated");
	zassert_ok(test_file_delete());
}

static void ls_l(const struct stat *st, const char *path)
{
	/*
	 * # directory: ls -lan /etc | grep " .$"
	 * drwxr-xr-x 158 0  0 12288 Jan  5 19:52 .
	 * # plain file: ls -lan /etc/fstab
	 * -rw-rw-r-- 1 0 0 741 Mar 21  2024 /etc/fstab
	 * # symbolic link: ls -lan /proc/self/fd/1
	 * lrwx------ 1 1000 1000 64 Jan 10 19:38 /proc/self/fd/1 -> /dev/pts/5
	 * # char file: ls -lan /dev/pts/5
	 * crw--w---- 1 1000 5 136, 5 Jan 10 20:12 /dev/pts/5
	 * # block file: ls -lan /dev/loop0
	 * brw-rw---- 1 0 6 7, 0 Jan 10 02:30 /dev/loop0
	 */
	char type;

	switch (st->st_mode & S_IFMT) {
	case S_IFBLK:
		type = 'b';
		break;
	case S_IFCHR:
		type = 'c';
		break;
	case S_IFDIR:
		type = 'd';
		break;
	case S_IFIFO:
		type = 'p';
		break;
	case S_IFLNK:
		type = 'l';
		break;
	case S_IFREG:
		type = '-';
		break;
	case S_IFSOCK:
		type = 's';
		break;
	default:
		type = '?';
		break;
	};

	char u_r = (st->st_mode & S_IRUSR) ? 'r' : '-';
	char u_w = (st->st_mode & S_IWUSR) ? 'w' : '-';
	char u_x = (st->st_mode & S_IXUSR) ? 'x' : '-';
	char g_r = (st->st_mode & S_IRGRP) ? 'r' : '-';
	char g_w = (st->st_mode & S_IWGRP) ? 'w' : '-';
	char g_x = (st->st_mode & S_IXGRP) ? 'x' : '-';
	char o_r = (st->st_mode & S_IROTH) ? 'r' : '-';
	char o_w = (st->st_mode & S_IWOTH) ? 'w' : '-';
	char o_x = (st->st_mode & S_IXOTH) ? 'x' : '-';

	printf("%c%c%c%c%c%c%c%c%c%c %lu\t%u\t%u\t%lu\t%lu\t%s%s%s\n", type, u_r, u_w, u_x, g_r,
	       g_w, g_x, o_r, o_w, o_x, (long unsigned)st->st_nlink, st->st_uid, st->st_gid,
	       st->st_size, st->st_mtime, path, type == 'l' ? " -> " : "",
	       type == 'l' ? "??????" : "");
};

ZTEST(posix_fs_file_test, test_file_fstat)
{
	int rc;
	struct stat st;

	file = rc = open(TEST_FILE, O_RDWR | O_CREAT, 0666);
	zassert_true(rc >= 0, "%s() failed: %d", "open", errno);

	zexpect_equal(write(file, TEST_FILE_CONTENTS, strlen(TEST_FILE_CONTENTS)),
		      strlen(TEST_FILE_CONTENTS));

	rc = fstat(file, &st);
	// zassert_ok(rc, "%s() failed: %d", "fstat", errno);
	if (rc < 0) {
		printf("%s() failed: %d\n", "fstat", errno);
	}

	ls_l(&st, TEST_FILE);
}

ZTEST(posix_fs_file_test, test_file_rlookup)
{
	int rc;
	static char buf[PATH_MAX];
	size_t size = sizeof(buf);

	file = rc = open(TEST_FILE, O_RDWR | O_CREAT, 0666);
	zassert_true(rc >= 0, "%s() failed: %d", "open", errno);

	rc = zvfs_rlookup(file, buf, &size);
	zexpect_ok(rc, "%s() failed: %d", "zvfs_rlookup", rc);
	zexpect_str_equal(buf, TEST_FILE);
}
```
