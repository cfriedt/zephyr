## CMakeLists.txt
```
# Copyright 2022 Meta
# SPDX-License-Identifier: Apache-2.0

cmake_minimum_required(VERSION 3.20.0)
find_package(Zephyr REQUIRED HINTS $ENV{ZEPHYR_BASE})
project(thrift_test)

set(THRIFT_UPSTREAM ${ZEPHYR_THRIFT_MODULE_DIR})
zephyr_include_directories(${ZEPHYR_BASE}/modules/thrift/src)
zephyr_include_directories(${THRIFT_UPSTREAM}/lib/cpp/src)

include(${ZEPHYR_BASE}/modules/thrift/cmake/thrift.cmake)

FILE(GLOB app_sources
    src/*.cpp
)

set(generated_sources "")
set(gen_dir ${ZEPHYR_BINARY_DIR}/misc/generated/thrift_ThriftTest)
list(APPEND generated_sources ${gen_dir}/gen-cpp/SecondService.cpp)
list(APPEND generated_sources ${gen_dir}/gen-cpp/SecondService.h)
list(APPEND generated_sources ${gen_dir}/gen-cpp/ThriftTest_constants.cpp)
list(APPEND generated_sources ${gen_dir}/gen-cpp/ThriftTest_constants.h)
list(APPEND generated_sources ${gen_dir}/gen-cpp/ThriftTest.cpp)
list(APPEND generated_sources ${gen_dir}/gen-cpp/ThriftTest.h)
list(APPEND generated_sources ${gen_dir}/gen-cpp/ThriftTest_types.cpp)
list(APPEND generated_sources ${gen_dir}/gen-cpp/ThriftTest_types.h)
list(APPEND app_sources ${generated_sources})

thrift(
    app
    cpp
    :no_skeleton
    ${gen_dir}
    # v0.16: ubuntu packaged thrift compiler does not support 'uuid' type
    "${THRIFT_UPSTREAM}/test/v0.16/ThriftTest.thrift"
    ""
    ${generated_sources}
)

target_sources(app PRIVATE ${app_sources})

# needed because std::iterator was deprecated with -std=c++17
target_compile_options(app PRIVATE -Wno-deprecated-declarations)

# convert .pem files to array data at build time
zephyr_include_directories(${gen_dir})

generate_inc_file_for_target(
    app
    ${ZEPHYR_BASE}/samples/modules/thrift/hello/qemu-cert.pem
    ${gen_dir}/qemu_cert.pem.inc
    )

generate_inc_file_for_target(
    app
    ${ZEPHYR_BASE}/samples/modules/thrift/hello/qemu-key.pem
    ${gen_dir}/qemu_key.pem.inc
    )
```

## Kconfig
```
# SPDX-License-Identifier: Apache-2.0
# Copyright (c) 2022 Meta

source "Kconfig.zephyr"

config THRIFTTEST_SERVER_STACK_SIZE
	int "ThriftTest Server stack size"
	default 4096

config THRIFTTEST_LOG_LEVEL
	int "ThriftTest log level"
	default 4

config THRIFT_COMPACT_PROTOCOL
	bool "Use TCompactProtocol for tests"
	depends on THRIFT
	help
	  Enable this option to include TCompactProtocol in tests
```

## prj.conf
```kconfig
CONFIG_REQUIRES_FULL_LIBC=y
CONFIG_COMMON_LIBC_MALLOC_ARENA_SIZE=65536

# CONFIG_THRIFT Dependencies
CONFIG_CPP=y
CONFIG_STD_CPP17=y
CONFIG_CPP_EXCEPTIONS=y
CONFIG_GLIBCXX_LIBCPP=y
CONFIG_POSIX_API=y
CONFIG_COMMON_LIBC_THRD=y
CONFIG_COMMON_LIBC_MALLOC=y
CONFIG_DYNAMIC_THREAD=y
CONFIG_MAX_PTHREAD_COUNT=8
CONFIG_DYNAMIC_THREAD_POOL_SIZE=8
CONFIG_DYNAMIC_THREAD_STACK_SIZE=8192
CONFIG_NETWORKING=y
CONFIG_NET_TCP=y
CONFIG_NET_SOCKETS=y
CONFIG_NET_SOCKETPAIR=y
CONFIG_HEAP_MEM_POOL_SIZE=16384
CONFIG_EVENTFD=y

CONFIG_THRIFT=y

# Test dependencies
CONFIG_ZTEST=y
CONFIG_TEST_RANDOM_GENERATOR=y
CONFIG_NET_TEST=y
CONFIG_NET_DRIVERS=y
CONFIG_NET_LOOPBACK=y
CONFIG_NET_TCP_TIME_WAIT_DELAY=100

# Some platforms require relatively large stack sizes.
# This can be tuned per-board.
CONFIG_ZTEST_STACK_SIZE=4096
CONFIG_MAIN_STACK_SIZE=4096
CONFIG_SYSTEM_WORKQUEUE_STACK_SIZE=4096
CONFIG_THRIFTTEST_SERVER_STACK_SIZE=8192
CONFIG_NET_TCP_WORKQ_STACK_SIZE=4096
CONFIG_NET_MGMT_EVENT_STACK_SIZE=4096
CONFIG_IDLE_STACK_SIZE=4096
CONFIG_NET_RX_STACK_SIZE=8192

CONFIG_NET_BUF_TX_COUNT=20
CONFIG_NET_PKT_TX_COUNT=20
CONFIG_NET_BUF_RX_COUNT=20
CONFIG_NET_PKT_RX_COUNT=20

# We can get away with using fewer sockets in the non-TLS tests because we use
# TFDServer.cpp for our server and socketpair() for our channel. We do not
# need an accept socket for the server (in contrast to TCP), it only needs 1
# eventfd for server cancellation, and there are no cancellation sockets
# required because we close them in the testsuite.
#
# File Descriptor Usage
# ---------------------
# stdin, stdout, stderr: 3
# socketpair for channel: 2
# eventfd for cancellation: 1
CONFIG_POSIX_MAX_FDS=6

# Network address config
CONFIG_NET_IPV4=y
CONFIG_NET_CONFIG_SETTINGS=y
CONFIG_NET_CONFIG_MY_IPV4_ADDR="192.0.2.1"

# CONFIG_DEBUG=y
# CONFIG_DEBUG_INFO=y
# CONFIG_NO_OPTIMIZATIONS=y

# CONFIG_PTHREAD_MUTEX_LOG_LEVEL_DBG=y
# CONFIG_PTHREAD_COND_LOG_LEVEL_DBG=y
CONFIG_PTHREAD_LOG_LEVEL_DBG=y
CONFIG_MAX_PTHREAD_MUTEX_COUNT=10
```

## src/main.cpp
```c
/*
 * Copyright 2022 Young Mei
 *
 * SPDX-License-Identifier: Apache-2.0
 */

#include <unistd.h>

#include <zephyr/ztest.h>

#include <thrift/protocol/TBinaryProtocol.h>
#include <thrift/protocol/TCompactProtocol.h>
#include <thrift/server/TSimpleServer.h>
#include <thrift/transport/TBufferTransports.h>
#include <thrift/transport/TFDTransport.h>
#include <thrift/transport/TSSLServerSocket.h>
#include <thrift/transport/TSSLSocket.h>
#include <thrift/transport/TServerSocket.h>

#include "context.hpp"
#include "server.hpp"
#include "thrift/server/TFDServer.h"

using namespace apache::thrift;
using namespace apache::thrift::protocol;
using namespace apache::thrift::transport;

ctx context;

static const char cert_pem[] = {
#include "qemu_cert.pem.inc"
	'\0'
};
static const char key_pem[] = {
#include "qemu_key.pem.inc"
	'\0'
};

static void *thrift_test_setup(void)
{
	if (IS_ENABLED(CONFIG_THRIFT_SSL_SOCKET)) {
		TSSLSocketFactory socketFactory;
		socketFactory.loadCertificateFromBuffer((const char *)&cert_pem[0]);
		socketFactory.loadPrivateKeyFromBuffer((const char *)&key_pem[0]);
		socketFactory.loadTrustedCertificatesFromBuffer((const char *)&cert_pem[0]);
	}

	return NULL;
}

std::unique_ptr<ThriftTestClient> setup_client()
{
	std::shared_ptr<TTransport> transport;
	std::shared_ptr<TProtocol> protocol;
	std::shared_ptr<TTransport> trans(new TFDTransport(context.fds[ctx::CLIENT]));

	if (IS_ENABLED(CONFIG_THRIFT_SSL_SOCKET)) {
		const int port = 4242;
		std::shared_ptr<TSSLSocketFactory> socketFactory =
			std::make_shared<TSSLSocketFactory>();
		socketFactory->authenticate(true);
		trans = socketFactory->createSocket(CONFIG_NET_CONFIG_MY_IPV4_ADDR, port);
	} else {
		trans = std::make_shared<TFDTransport>(context.fds[ctx::CLIENT]);
	}

	transport = std::make_shared<TBufferedTransport>(trans);

	if (IS_ENABLED(CONFIG_THRIFT_COMPACT_PROTOCOL)) {
		protocol = std::make_shared<TCompactProtocol>(transport);
	} else {
		protocol = std::make_shared<TBinaryProtocol>(transport);
	}
	transport->open();
	return std::unique_ptr<ThriftTestClient>(new ThriftTestClient(protocol));
}

static std::unique_ptr<TServer> setup_server()
{
	std::shared_ptr<TestHandler> handler(new TestHandler());
	std::shared_ptr<TProcessor> processor(new ThriftTestProcessor(handler));
	std::shared_ptr<TServerTransport> serverTransport;
	std::shared_ptr<TProtocolFactory> protocolFactory;
	std::shared_ptr<TTransportFactory> transportFactory;

	if (IS_ENABLED(CONFIG_THRIFT_SSL_SOCKET)) {
		const int port = 4242;
		std::shared_ptr<TSSLSocketFactory> socketFactory(new TSSLSocketFactory());
		socketFactory->server(true);
		serverTransport =
			std::make_shared<TSSLServerSocket>("0.0.0.0", port, socketFactory);
	} else {
		serverTransport = std::make_shared<TFDServer>(context.fds[ctx::SERVER]);
	}

	transportFactory = std::make_shared<TBufferedTransportFactory>();

	if (IS_ENABLED(CONFIG_THRIFT_COMPACT_PROTOCOL)) {
		protocolFactory = std::make_shared<TCompactProtocolFactory>();
	} else {
		protocolFactory = std::make_shared<TBinaryProtocolFactory>();
	}
	TSimpleServer server(processor, serverTransport, transportFactory, protocolFactory);
	return std::unique_ptr<TServer>(
		new TSimpleServer(processor, serverTransport, transportFactory, protocolFactory));
}

static void thrift_test_before(void *data)
{
	ARG_UNUSED(data);
	int rv;

	// create the communication channel
	printf("creating socketpair\n");
	rv = socketpair(AF_UNIX, SOCK_STREAM, 0, &context.fds.front());
	zassert_equal(0, rv, "socketpair failed: %d\n", rv);

	// set up server
	printf("setting up server..\n");
	context.server = setup_server();
	printf("finished setting up server\n");
}

static void thrift_test_after(void *data)
{
	ARG_UNUSED(data);

	for (auto &fd : context.fds) {
		printf("closing fd %d\n", fd);
		close(fd);
		fd = -1;
	}

	// try {
	// printf("resetting client..\n");
	// context.client.reset();
	// printf("resetting server..\n");
	// context.server.reset();
	// } catch (std::exception &e) {
	// 	printf("failed: %s\n", e.what());
	// }

	// k_msleep(CONFIG_NET_TCP_TIME_WAIT_DELAY);
}

ZTEST_SUITE(thrift, NULL, thrift_test_setup, thrift_test_before, thrift_test_after, NULL);
```

## src/client.cpp
```c
/*
 * Copyright 2022 Young Mei
 *
 * SPDX-License-Identifier: Apache-2.0
 */

#include <zephyr/ztest.h>

#include <array>
#include <cfloat>
#include <locale>
#include <stdexcept>

#include <sys/time.h>

#include "context.hpp"

using namespace apache::thrift;

using namespace std;

static void init_Xtruct(Xtruct &s);

ZTEST(thrift, test_void)
{
	PRE();

	context.client->testVoid();

	POST();
}

ZTEST(thrift, test_string)
{
	PRE();

	string s;
	context.client->testString(s, "Test");
	zassert_equal(s, "Test", "");

	POST();
}

ZTEST(thrift, test_bool)
{
	PRE();

	zassert_equal(false, context.client->testBool(false), "");
	zassert_equal(true, context.client->testBool(true), "");

	POST();
}

ZTEST(thrift, test_byte)
{
	PRE();

	zassert_equal(0, context.client->testByte(0), "");
	zassert_equal(-1, context.client->testByte(-1), "");
	zassert_equal(42, context.client->testByte(42), "");
	zassert_equal(-42, context.client->testByte(-42), "");
	zassert_equal(127, context.client->testByte(127), "");
	zassert_equal(-128, context.client->testByte(-128), "");

	POST();
}

ZTEST(thrift, test_i32)
{
	PRE();

	zassert_equal(0, context.client->testI32(0), "");
	zassert_equal(-1, context.client->testI32(-1), "");
	zassert_equal(190000013, context.client->testI32(190000013), "");
	zassert_equal(-190000013, context.client->testI32(-190000013), "");
	zassert_equal(INT32_MAX, context.client->testI32(INT32_MAX), "");
	zassert_equal(INT32_MIN, context.client->testI32(INT32_MIN), "");

	POST();
}

ZTEST(thrift, test_i64)
{
	PRE();

	zassert_equal(0, context.client->testI64(0), "");
	zassert_equal(-1, context.client->testI64(-1), "");
	zassert_equal(7000000000000000123LL, context.client->testI64(7000000000000000123LL), "");
	zassert_equal(-7000000000000000123LL, context.client->testI64(-7000000000000000123LL), "");
	zassert_equal(INT64_MAX, context.client->testI64(INT64_MAX), "");
	zassert_equal(INT64_MIN, context.client->testI64(INT64_MIN), "");

	POST();
}

ZTEST(thrift, test_double)
{
	PRE();

	zassert_equal(0.0, context.client->testDouble(0.0), "");
	zassert_equal(-1.0, context.client->testDouble(-1.0), "");
	zassert_equal(-5.2098523, context.client->testDouble(-5.2098523), "");
	zassert_equal(-0.000341012439638598279,
		      context.client->testDouble(-0.000341012439638598279), "");
	zassert_equal(DBL_MAX, context.client->testDouble(DBL_MAX), "");
	zassert_equal(-DBL_MAX, context.client->testDouble(-DBL_MAX), "");

	POST();
}

ZTEST(thrift, test_binary)
{
	try {
	string rsp;

	//PRE();

	std::thread th([]{context.server->serve();});
	k_msleep(100);
	context.client = setup_client();


	context.client->testBinary(rsp, "");
	zassert_equal("", rsp, "");
	context.client->testBinary(rsp, "Hello");
	zassert_equal("Hello", rsp, "");
	context.client->testBinary(rsp, "H\x03\x01\x01\x00");
	zassert_equal("H\x03\x01\x01\x00", rsp, "");

	context.server->stop();
	th.join();

	} catch( std::exception& e ) {
		printf("failed: %s\n", e.what());
	}
}

ZTEST(thrift, test_struct)
{
	PRE();

	Xtruct request_struct;
	init_Xtruct(request_struct);
	Xtruct response_struct;
	context.client->testStruct(response_struct, request_struct);

	zassert_equal(response_struct, request_struct, NULL);

	POST();
}

ZTEST(thrift, test_nested_struct)
{
	PRE();

	Xtruct2 request_struct;
	request_struct.byte_thing = 1;
	init_Xtruct(request_struct.struct_thing);
	request_struct.i32_thing = 5;
	Xtruct2 response_struct;
	context.client->testNest(response_struct, request_struct);

	zassert_equal(response_struct, request_struct, NULL);

	POST();
}

ZTEST(thrift, test_map)
{
	PRE();

	static const map<int32_t, int32_t> request_map = {
		{0, -10}, {1, -9}, {2, -8}, {3, -7}, {4, -6}};

	map<int32_t, int32_t> response_map;
	context.client->testMap(response_map, request_map);

	zassert_equal(request_map, response_map, "");

	POST();
}

ZTEST(thrift, test_string_map)
{
	PRE();

	static const map<string, string> request_smap = {
		{"a", "2"}, {"b", "blah"}, {"some", "thing"}
	};
	map<string, string> response_smap;

	context.client->testStringMap(response_smap, request_smap);
	zassert_equal(response_smap, request_smap, "");

	POST();
}

ZTEST(thrift, test_set)
{
	PRE();

	static const set<int32_t> request_set = {-2, -1, 0, 1, 2};

	set<int32_t> response_set;
	context.client->testSet(response_set, request_set);

	zassert_equal(request_set, response_set, "");

	POST();
}

ZTEST(thrift, test_list)
{
	PRE();

	vector<int32_t> response_list;
	context.client->testList(response_list, vector<int32_t>());
	zassert_true(response_list.empty(), "Unexpected list size: %llu", response_list.size());

	static const vector<int32_t> request_list = {-2, -1, 0, 1, 2};

	response_list.clear();
	context.client->testList(response_list, request_list);
	zassert_equal(request_list, response_list, "");

	POST();
}

ZTEST(thrift, test_enum)
{
	PRE();

	Numberz::type response = context.client->testEnum(Numberz::ONE);
	zassert_equal(response, Numberz::ONE, NULL);

	response = context.client->testEnum(Numberz::TWO);
	zassert_equal(response, Numberz::TWO, NULL);

	response = context.client->testEnum(Numberz::EIGHT);
	zassert_equal(response, Numberz::EIGHT, NULL);

	POST();
}

ZTEST(thrift, test_typedef)
{
	PRE();

	UserId uid = context.client->testTypedef(309858235082523LL);
	zassert_equal(uid, 309858235082523LL, "Unexpected uid: %llu", uid);

	POST();
}

ZTEST(thrift, test_nested_map)
{
	PRE();

	map<int32_t, map<int32_t, int32_t>> mm;
	context.client->testMapMap(mm, 1);

	zassert_equal(mm.size(), 2, NULL);
	zassert_equal(mm[-4][-4], -4, NULL);
	zassert_equal(mm[-4][-3], -3, NULL);
	zassert_equal(mm[-4][-2], -2, NULL);
	zassert_equal(mm[-4][-1], -1, NULL);
	zassert_equal(mm[4][4], 4, NULL);
	zassert_equal(mm[4][3], 3, NULL);
	zassert_equal(mm[4][2], 2, NULL);
	zassert_equal(mm[4][1], 1, NULL);

	POST();
}

ZTEST(thrift, test_exception)
{
	PRE();

	std::exception_ptr eptr = nullptr;

	try {
		context.client->testException("Xception");
	} catch (...) {
		eptr = std::current_exception();
	}
	zassert_not_equal(nullptr, eptr, "an exception was not thrown");

	eptr = nullptr;
	try {
		context.client->testException("TException");
	} catch (...) {
		eptr = std::current_exception();
	}
	zassert_not_equal(nullptr, eptr, "an exception was not thrown");

	context.client->testException("success");

	POST();
}

ZTEST(thrift, test_multi_exception)
{
	PRE();

	std::exception_ptr eptr = nullptr;

	try {
		Xtruct result;
		context.client->testMultiException(result, "Xception", "test 1");
	} catch (...) {
		eptr = std::current_exception();
	}
	zassert_not_equal(nullptr, eptr, "an exception was not thrown");

	eptr = nullptr;
	try {
		Xtruct result;
		context.client->testMultiException(result, "Xception2", "test 2");
	} catch (...) {
		eptr = std::current_exception();
	}
	zassert_not_equal(nullptr, eptr, "an exception was not thrown");

	POST();
}

static void init_Xtruct(Xtruct &s)
{
	PRE();

	s.string_thing = "Zero";
	s.byte_thing = 1;
	s.i32_thing = -3;
	s.i64_thing = -5;

	POST();
}
```

## src/context.hpp
```c
/*
 * Copyright 2022 Young Mei
 *
 * SPDX-License-Identifier: Apache-2.0
 */

#ifndef TESTS_LIB_THRIFT_THRIFTTEST_SRC_CONTEXT_HPP_
#define TESTS_LIB_THRIFT_THRIFTTEST_SRC_CONTEXT_HPP_

#include <pthread.h>

#include <memory>

#include <thrift/server/TSimpleServer.h>

#include "ThriftTest.h"

using namespace apache::thrift::server;
using namespace thrift::test;

struct ctx {
	enum {
		SERVER,
		CLIENT,
	};

	std::array<int, CLIENT + 1> fds;
	std::unique_ptr<ThriftTestClient> client;
	std::unique_ptr<TServer> server;
	std::thread server_thread;
};

std::unique_ptr<ThriftTestClient> setup_client();

extern ctx context;

#define PRE() \
	std::thread th([]{context.server->serve();}); \
	k_msleep(100); \
	context.client = setup_client()

#define POST() \
	context.server->stop(); \
	th.join()

#endif /* TESTS_LIB_THRIFT_THRIFTTEST_SRC_CONTEXT_HPP_ */
```
