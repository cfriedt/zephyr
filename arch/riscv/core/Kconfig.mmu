## arch/riscv/core/Kconfig.mmu
```kconfig
# Copyright (c) 2026 Baochip contributors
# SPDX-License-Identifier: Apache-2.0

config RISCV_MMU
	bool "RISC-V MMU support"
	depends on RISCV_S_MODE
	select CPU_HAS_MMU
	select MMU
	help
	  Enable RISC-V virtual memory using satp-based page tables. The kernel
	  must run in S-mode (CONFIG_RISCV_S_MODE). Paging is enabled during
	  early boot before z_cstart().

if RISCV_MMU

choice
	prompt "RISC-V MMU paging mode"
	default RISCV_MMU_SV39 if 64BIT
	default RISCV_MMU_SV32 if !64BIT

config RISCV_MMU_SV32
	bool "Sv32 (2-level, RV32)"
	depends on !64BIT
	help
	  32-bit virtual addresses with a two-level page table.

config RISCV_MMU_SV39
	bool "Sv39 (3-level)"
	help
	  39-bit virtual addresses with a three-level page table. Required for
	  RV64 and for RV32 cores such as VexRiscv on Baochip bao1x.

endchoice

config MAX_RISCV_PT_TABLES
	int "Maximum number of page table pages"
	default 32
	range 4 256
	help
	  Number of 4 KiB page table pages reserved at build time. Each
	  map/unmap operation may consume tables from this pool.

config RISCV_MMU_BOOT_IO_SIZE
	hex "Low physical address range to identity-map at boot"
	default 0x10000000
	help
	  Identity-map physical addresses [0, size) when enabling the MMU so
	  MMIO devices (UART, interrupt controllers, etc.) remain accessible
	  before drivers call arch_mem_map().

endif # RISCV_MMU
```

## boards/baochip/bao1x/Kconfig.bao1x
```kconfig
# Copyright (c) 2026 Baochip contributors
# SPDX-License-Identifier: Apache-2.0

config BOARD_BAO1X
	select SOC_BAO1X
```

## boards/baochip/bao1x/bao1x_bao1x_renode_defconfig
```kconfig
# SPDX-License-Identifier: Apache-2.0

CONFIG_CONSOLE=y
CONFIG_SERIAL=y
CONFIG_UART_CONSOLE=y
CONFIG_XIP=n
CONFIG_RISCV_S_MODE=y
CONFIG_RISCV_MMU=y
CONFIG_RISCV_MMU_SV39=y
CONFIG_UART_INTERRUPT_DRIVEN=n
```

## boards/baochip/bao1x/board.yml
```yaml
board:
  name: bao1x
  full_name: Baochip-1x
  vendor: baochip
  socs:
  - name: bao1x
    variants:
    - name: renode
```

## boards/qemu/riscv64/qemu_riscv64_qemu_virt_riscv64_smode_mmu_defconfig
```kconfig
# SPDX-License-Identifier: Apache-2.0

CONFIG_CONSOLE=y
CONFIG_SERIAL=y
CONFIG_UART_CONSOLE=y
CONFIG_STACK_SENTINEL=y
CONFIG_XIP=n
CONFIG_RISCV_S_MODE=y
CONFIG_SHELL_BACKEND_SERIAL_INTERRUPT_DRIVEN=n
CONFIG_RISCV_MMU=y
CONFIG_RISCV_MMU_SV39=y
CONFIG_MMU_PAGE_SIZE=0x1000
CONFIG_MAX_RISCV_PT_TABLES=32
CONFIG_KERNEL_VM_SIZE=0x8000000
```

## boards/sipeed/tang_mega_138k_dock/Kconfig.defconfig
```kconfig
# Copyright (c) 2026 Chris Friedt
# SPDX-License-Identifier: Apache-2.0

config XIP
	default y
```

## boards/sipeed/tang_mega_138k_dock/Kconfig.tang_mega_138k_dock
```kconfig
# Copyright (c) 2026 Chris Friedt
# SPDX-License-Identifier: Apache-2.0

config BOARD_TANG_MEGA_138K_DOCK
	select SOC_AE350
```

## boards/sipeed/tang_mega_138k_dock/board.yml
```yaml
board:
  name: tang_mega_138k_dock
  full_name: Tang Mega 138K Dock
  vendor: sipeed
  socs:
    - name: ae350
```

## drivers/serial/Kconfig.baochip
```kconfig
# Copyright (c) 2026 Baochip contributors
# SPDX-License-Identifier: Apache-2.0

config UART_BAOCHIP_DUART
	bool "Baochip DUART serial driver"
	default y
	depends on DT_HAS_BAOCHIP_DUART_ENABLED
	select SERIAL_HAS_DRIVER
	help
	  Polled driver for the Baochip debug UART block.
```

## dts/bindings/serial/baochip,duart.yaml
```yaml
# Copyright (c) 2026 Baochip contributors
# SPDX-License-Identifier: Apache-2.0

description: Baochip debug UART (DUART)

compatible: "baochip,duart"

include: uart-controller.yaml

properties:
  reg:
    required: true
```

## lib/elastipool/Kconfig
```kconfig
# SPDX-License-Identifier: Apache-2.0

config SYS_ELASTIPOOL
	bool "Elastic memory pool"
	depends on SYS_HASH_MAP
	help
	  Say 'y' here to enable the elastic memory pool ("elastipool") API.

	  The elastic memory pool API supports allocation of fixed-size objects from either
	  a statically allocated pool of objects, or dynamically allocation from the heap, or
	  both, up to a maximum number of allocations.
```

## samples/modules/nanopb/grpc/sample.yaml
```yaml
sample:
  description: Nanopb sample with gRPC
  name: Simple gRPC demo
common:
  modules:
    - grpc
    - nanopb
    - samples
  harness: console
  harness_config:
    type: one_line
    regex:
      - "SUCCESS"
tests:
  sample.modules.nanopb.grpc:
    integration_platforms:
      - native_sim
      - native_sim/native/64
```

## soc/baochip/Kconfig
```kconfig
# Copyright (c) 2026 Baochip contributors
# SPDX-License-Identifier: Apache-2.0

if SOC_FAMILY_BAOCHIP

rsource "*/Kconfig"

endif # SOC_FAMILY_BAOCHIP
```

## soc/baochip/Kconfig.soc
```kconfig
# Copyright (c) 2026 Baochip contributors
# SPDX-License-Identifier: Apache-2.0

config SOC_FAMILY_BAOCHIP
	bool

config SOC_FAMILY
	default "baochip" if SOC_FAMILY_BAOCHIP

rsource "*/Kconfig.soc"
```

## soc/baochip/bao1x/Kconfig
```kconfig
# Copyright (c) 2026 Baochip contributors
# SPDX-License-Identifier: Apache-2.0

config SOC_BAO1X
	select RISCV
	select RISCV_PRIVILEGED
	select INCLUDE_RESET_VECTOR
	select RISCV_SOC_HAS_GP_RELATIVE_ADDRESSING
```

## soc/baochip/bao1x/Kconfig.defconfig
```kconfig
# Copyright (c) 2026 Baochip contributors
# SPDX-License-Identifier: Apache-2.0

if SOC_BAO1X

config NUM_IRQS
	default 32

endif # SOC_BAO1X
```

## soc/baochip/bao1x/Kconfig.soc
```kconfig
# Copyright (c) 2026 Baochip contributors
# SPDX-License-Identifier: Apache-2.0

config SOC_SERIES
	default "bao1x" if SOC_SERIES_BAO1X

config SOC_SERIES_BAO1X
	bool
	select SOC_FAMILY_BAOCHIP

config SOC_BAO1X
	bool
	select SOC_SERIES_BAO1X

config SOC
	default "bao1x" if SOC_BAO1X
```

## subsys/kcl/Kconfig
```kconfig
# Copyright (c) 2025, Friedt Professional Engineering Services Inc.
#
# SPDX-License-Identifier: Apache-2.0

config KCL
	bool "Kernel compatibility layer"
	help
	  Select 'y' here to enable the kernel compatibility layer (KCL).

	  The KCL provides a compatibility layer that maps system calls to Zephyr kernel APIs.
	  This allows applications written for other Operating Systems to run on Zephyr with
	  minimal modifications.

choice KCL_CHOICE
	prompt "Select a kernel compatibility layer"
	default KCL_CHOICE_NONE
	help
	  Select the kernel compatibility layer to use.

	  The KCL provides a compatibility layer that maps system calls to Zephyr kernel APIs.
	  This allows applications written for other Operating Systems to run on Zephyr with
	  minimal modifications.

config KCL_CHOICE_NONE
	bool "None"
	default y
	help
	  No kernel compatibility layer selected. Only Zephyr's native system calls are available.

config KCL_CHOICE_LINUX
	bool "Linux"
	help
	  Select 'y' here to enable the Linux kernel compatibility layer.

endchoice
```

## tests/arch/riscv/riscv_mmu/testcase.yaml
```yaml
tests:
  arch.riscv.mmu:
    platform_allow: qemu_riscv64/qemu_virt_riscv64/smode_mmu
```

## tests/drivers/i2c/i2c_timeout/testcase.yaml
```yaml
tests:
  drivers.i2c.timeout:
    platform_allow:
      - native_sim
    depends_on: i2c
    tags:
      - drivers
      - i2c
```

## tests/posix/multi_process/testcase.yaml
```yaml
common:
  filter: not CONFIG_NATIVE_LIBC
  tags:
    - posix
    - multi_process
  # 1 tier0 platform per supported architecture
  platform_key:
    - arch
    - simulation
  integration_platforms:
    - qemu_xtensa
    - qemu_riscv64
  min_flash: 64
  min_ram: 32
tests:
  portability.posix.multi_process: {}
```
